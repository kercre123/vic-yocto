## poky/meta-qti-bsp/conf/machine/include/basemachine.inc
```bitbake
BASEMACHINE ??= ""

# Add BASEMACHINE to machine overrides
MACHINEOVERRIDES =. "${@['', '${BASEMACHINE}:']['${BASEMACHINE}' != '']}"

# Define BASEMACHINE_ARCH
BASEMACHINE_ARCH = "${@['${MACHINE_ARCH}', '${BASEMACHINE}']['${BASEMACHINE}' != '']}"

# Add BASEMACHINE_ARCH to PACKAGE_ARCHS. 
# This variable is originally set in bitbake.conf
PACKAGE_ARCHS .= "${@['', ' ${BASEMACHINE_ARCH}']['${BASEMACHINE_ARCH}' != '${MACHINE_ARCH}']}"
PACKAGE_ARCHS[vardepsexclude] += "BASEMACHINE_ARCH"

# Default Image names
BOOTIMAGE_TARGET ?= "${BASEMACHINE}-boot.img"
CACHEIMAGE_TARGET ?= "${BASEMACHINE}-cache.ext4"
PERSISTIMAGE_TARGET ?= "${BASEMACHINE}-persist.ext4"
RECOVERYIMAGE_TARGET ?= "${BASEMACHINE}-recoveryfs.ext4"
SYSTEMIMAGE_TARGET ?= "${BASEMACHINE}-sysfs.ext4"
SYSTEMRWIMAGE_TARGET ?= "${BASEMACHINE}-systemrw.ext4"
USERDATAIMAGE_TARGET ?= "${BASEMACHINE}-usrfs.ext4"
```

## poky/meta-qti-bsp/conf/machine/include/mdm9607.inc
```bitbake
BASEMACHINE ?= "mdm9607"
require conf/machine/include/basemachine.inc

SOC_FAMILY ?= "mdm9x07"
include conf/machine/include/soc-family.inc

#TCLIBC = "musl"

# Pull in security flags
require ${COREBASE}/meta-qti-bsp/conf/distro/include/security_flags.inc

require conf/machine/include/tune-cortexa8.inc

PREFERRED_PROVIDER_virtual/kernel = "linux-msm"
PREFERRED_VERSION_linux-msm ?= "3.18"

BBMASK = ".*/*/recipes-devtools/mtd/"
#BBMASK .= "|.*/*/recipes-security/libselinux/"

MACHINE_DISPLAY_WIDTH_PIXELS ?= "480"
MACHINE_DISPLAY_HEIGHT_PIXELS ?= "640"

SERIAL_CONSOLE ?= "115200 ttyHSL0"

DISTRO ?= "mdm"

MACHINE_FEATURES += "kernel26 keyboard"

PAGE_SIZE ?= '4096'

# Max supported inodes
EXTRA_IMAGECMD ?= "-N 2048"

#UBINIZE Args
UBINIZE_ARGS ?= "-m 4096 -p 256KiB -s 4096"
#MKUBIFS Arg
MKUBIFS_ARGS ?= "-m 4096 -e 253952 -c 2146 -F"
#Volume sizes
SYSTEM_VOLUME_SIZE ?= "100MiB"
CACHE_VOLUME_SIZE ?= "50MiB"
SYSTEMRW_VOLUME_SIZE ?= "6MiB"

# Formats of root filesystem images.
IMAGE_FSTYPES += "ubi"

MACHINE_MNT_POINTS = "/persist"
```

## poky/meta-qti-bsp/conf/machine/include/sdm845.inc
```bitbake
BASEMACHINE ?= "sdm845"
require conf/machine/include/basemachine.inc

SOC_FAMILY ?= "sdm845"
include conf/machine/include/soc-family.inc

# Pull in security flags
require ${COREBASE}/meta-qti-bsp/conf/distro/include/security_flags.inc

require conf/machine/include/arm/arch-armv8.inc

PREFERRED_PROVIDER_virtual/kernel = "linux-msm"
PREFERRED_VERSION_linux-msm = "4.9"

PREFERRED_PROVIDER_virtual/egl ?= "adreno"
PREFERRED_PROVIDER_virtual/libgles1 ?= "adreno"
PREFERRED_PROVIDER_virtual/libgles2 ?= "adreno"

SERIAL_CONSOLE ?= "${@['', '115200 ttyMSM0'][d.getVar('VARIANT', True) == ('' or 'debug')]}"

DISTRO ?= "msm"

DISTRO_FEATURES += "persist-image"
DISTRO_FEATURES += "ab-boot-support"
DISTRO_FEATURES += "gbm"

# drm driver
MACHINE_FEATURES += "drm"

PAGE_SIZE ?= '4096'

# Max supported inodes
EXTRA_IMAGECMD ?= "-N 2048"

MACHINE_MNT_POINTS = "/firmware /persist /cache /dsp /bt_firmware"

# Sizes for EXT4 (in bytes)
SYSTEM_SIZE_EXT4 ?= "3221225472"
SYSTEMRW_SIZE_EXT4 ?= "8388608"
USERDATA_SIZE_EXT4 ?= "5000000000"
CACHE_SIZE_EXT4 ?= "65536000"
RECOVERYFS_SIZE_EXT4 ?= "136000000"

# Enable LE Verified Boot
DISTRO_FEATURES_append = " vble"

#Enable SDK feature
# SDK_IMAGE ?= "1"

#Enable Recovery image generation
RECOVERY_IMAGE ?= "0"

# Formats of root filesystem images.
IMAGE_FSTYPES += "ext4"
```

## poky/meta-qti-bsp/conf/machine/include/sdxpoorwills.inc
```bitbake
BASEMACHINE ?= "sdxpoorwills"
require conf/machine/include/basemachine.inc

SOC_FAMILY ?= "mdm9x50"
include conf/machine/include/soc-family.inc

# Pull in security flags
require ${COREBASE}/meta-qti-bsp/conf/distro/include/security_flags.inc

include conf/machine/include/tune-cortexa8.inc

PREFERRED_PROVIDER_virtual/kernel = "linux-msm"
PREFERRED_VERSION_linux-msm = "4.9"

MACHINE_DISPLAY_WIDTH_PIXELS ?= "480"
MACHINE_DISPLAY_HEIGHT_PIXELS ?= "640"

SERIAL_CONSOLES ?= "115200;ttyMSM0"

DISTRO ?= "mdm"

DISTRO_FEATURES_append = " persist-volume"

#Disable ssd listener
DISTRO_FEATURES_append = " no-ssd-listener-support"

#Disable rpmb listner
DISTRO_FEATURES_append = " no-rpmb-listener-support"

MACHINE_FEATURES += "kernel26 keyboard ipa-offload"

PAGE_SIZE ?= '4096'

# Max supported inodes
EXTRA_IMAGECMD ?= "-N 2048"

#UBINIZE Args
UBINIZE_ARGS ?= "-m 4096 -p 256KiB -s 4096"
#MKUBIFS Args
MKUBIFS_ARGS ?= "-m 4096 -e 253952 -c 2146 -F"
#Volume sizes
SYSTEM_VOLUME_SIZE ?= "90MiB"
CACHE_VOLUME_SIZE ?= "70MiB"
SYSTEMRW_VOLUME_SIZE ?= "6MiB"
PERSIST_VOLUME_SIZE ?= "6MiB"

# Sizes for EXT4 (in bytes)
SYSTEM_SIZE_EXT4 ?= "100000000"
SYSTEMRW_SIZE_EXT4 ?= "8388608"
USERDATA_SIZE_EXT4 ?= "2000000000"
CACHE_SIZE_EXT4 ?= "80000000"

# Enable LE Verified Boot
DISTRO_FEATURES_append = " vble"

# Formats of root filesystem images.
IMAGE_FSTYPES += "ubi"
```

## poky/meta-qti-bsp/conf/machine/mdm9607.conf
```bitbake
#@TYPE: Machine
#@NAME: MDM9607 CDP
#@DESCRIPTION: Machine configuration for QTI MDM9607 CDP

require conf/machine/include/mdm9607.inc

KERNEL_IMAGETYPE = "zImage-dtb"
KERNEL_DTS_NAME = "mdm9607"
KERNEL_BASE = "0x80000000"
KERNEL_TAGS_OFFSET = "0x81E00000"

KERNEL_CONFIG = "${@['mdm9607-perf_defconfig', 'mdm9607_defconfig'][d.getVar('VARIANT', True) == ('' or 'debug')]}"

KERNEL_CMD_PARAMS ?= "noinitrd ro console=ttyHSL0,115200,n8 androidboot.hardware=qcom ehci-hcd.park=3 msm_rtb.filter=0x37 lpm_levels.sleep_disabled=1 earlycon=msm_hsl_uart,0x78b3000"
KERNEL_CMD_PARAMS_remove ?= "${@bb.utils.contains_any('VARIANT', 'perf user', 'console=ttyHSL0,115200,n8', '', d)}"

#Enable Recovery image generation
RECOVERY_IMAGE = "1"
```

## poky/meta-qti-bsp/conf/machine/nf-64.conf
```bitbake
#@TYPE: Machine
#@DESCRIPTION: Machine configuration for QTI nf-64
require conf/machine/include/qcs40x.inc
# TARGET TO SUPPORT 64-bit kernel
DISTRO = "qsap"

#boot image
BOOTIMAGE_TARGET = "boot.img"

#EXT4 FILES NAME
CACHEIMAGE_TARGET    = "cache.img"
PERSISTIMAGE_TARGET  = "persist.img"
RECOVERYIMAGE_TARGET = "recoveryfs.img"
SYSTEMIMAGE_TARGET   = "system.img"
SYSTEMRWIMAGE_TARGET = "systemrw.img"
USERDATAIMAGE_TARGET = "usrdata.img"

#recovery images
RECOVERYFS_SQUASHFS_IMAGE = "${DEPLOY_DIR_IMAGE_NAND}/recoveryfs.squash"
RECOVERYFS_SQUASHFS_UBI_IMAGE = "${DEPLOY_DIR_IMAGE_NAND}/recoveryfs.ubi"

#defconfig to be used for nf-64
KERNEL_CONFIG = "${@['vendor/qcs403-perf_defconfig', 'vendor/qcs403_defconfig'][d.getVar('VARIANT', True) == ('' or 'debug')]}"

# Sizes for EXT4 (in bytes)
SYSTEM_SIZE_EXT4 ?= "${@bb.utils.contains('DEBUG_BUILD', '1', '5368709120', '681574400', d)}"
SYSTEMRW_SIZE_EXT4 ?= "8388608"
USERDATA_SIZE_EXT4 ?= "5014746624"
CACHE_SIZE_EXT4 ?= "80000000"

#Deploy PATH for ext4 images
DEPLOY_DIR_IMAGE_EMMC = "${DEPLOY_DIR_IMAGE}/emmc-ext4"

#Enable verity feature
DISTRO_FEATURES += "dm-verity"

#verity required paths.
#Verity is supported only for emmc.
VERITY_IMAGE_DIR      = "${DEPLOY_DIR_IMAGE_EMMC}/verity"
SPARSE_SYSTEM_IMG     = "${DEPLOY_DIR_IMAGE_EMMC}/${SYSTEMIMAGE_TARGET}"

PAGE_SIZE ?= '4096'
PRODUCT_TYPE = "speaker"

#Target to support NAND build also.
DISTRO_FEATURES += "nand-boot"
DISTRO_FEATURES_NATIVE_append = " nand-boot "

#enable syslg error in nightfury device
PACKAGECONFIG_append_pn-adk-utils = " syslog error"
#NAND PARAMETERS
#Final system partition name.
OUTPUT_FILE_FINAL_SQUASHFS_UBI = "${DEPLOY_DIR_IMAGE_NAND}/system.ubi"
UBIFS_UBI_IMAGE      = "system-ubifs.ubi"
#system volume name
SQUASHFS_SYS_VOLUME = "system.squash"
# usrfs volume.
USR_IMAGE_BASENAME  = "userdata"
# persist volume = "persist.ubifs"
OUTPUT_FILE_PERSIST_UBIFS = "${DEPLOY_DIR_IMAGE_NAND}/persist.ubifs"
#Final system partition name.
OUTPUT_FILE_FINAL_SQUASHFS_UBI = "${DEPLOY_DIR_IMAGE_NAND}/system.ubi"
# Max supported inodes
EXTRA_IMAGECMD ?= "-N 2048"
#UBINIZE Args
UBINIZE_ARGS ?= "-m 4096 -p 256KiB -s 4096"
#MKUBIFS Args
MKUBIFS_ARGS ?= "-m 4096 -e 253952 -c 2146 -F"
# Limiting squashfs rootfs size to 110MiB (size should be multiple of LEB, LEB is 253952 bytes)
SYSTEM_SQUASHFS_VOLUME_SIZE = "125829120"
#Volume sizes
CACHE_VOLUME_SIZE ?= "81MiB"
SYSTEMRW_VOLUME_SIZE ?= "6MiB"
PERSIST_VOLUME_SIZE ?= "12MiB"
#Deploy path for ubi images
DEPLOY_DIR_IMAGE_NAND = "${DEPLOY_DIR_IMAGE}/nand-squashfs"


MACHINE_MNT_POINTS = "/firmware /persist /cache /dsp /bt_firmware"

# Set ab-boot-support feature for native tools as well,
# as some native tools have workflow chnages for AB builds.
DISTRO_FEATURES += "ab-boot-support"
DISTRO_FEATURES_NATIVE_append = " ab-boot-support "

# Formats of root filesystem images.
IMAGE_FSTYPES += "ubi ext4"

#Disable ssd listener
DISTRO_FEATURES_append = " no-ssd-listener-support"

#Disable rpmb listener
DISTRO_FEATURES_append = " no-rpmb-listener-support"

# enable audio as a loadable kernel module
DISTRO_FEATURES_append = " audio-dlkm"
DISTRO_FEATURES_append = " persist-volume"
DISTRO_FEATURES_append = " nand-squashfs"
DEFAULTTUNE = "aarch64"
MKUBIFS_PERSIST_ARGS = "-m 4096 -e 253952 -c 2146 -F"
RECOVERY_IMAGE = "0"

KERNEL_IMAGETYPE = "Image.gz-dtb"

require conf/multilib.conf
MULTILIBS = "multilib:lib32"
DEFAULTTUNE_virtclass-multilib-lib32 = "armv7ahf-neon"
TARGET_VENDOR_virtclass-multilib-lib32="-oe"

# Flag to Enable QPermissions
QPERMISSIONS_ENABLE = "1"

QPERM_FILE_pn-start-script-ab-slot-util = "${bindir}/getslotsuffix:0:1000"
QPERM_FILE_pn-system-core = "${sysconfdir}/build.prop:5002:5002"
QPERM_FILE_pn-system-prop = "/build.prop:5002:5002"
QPERM_FILE_pn-alm         = "/persist/data:1000:1000"
#Config to be used for persist.ext4
PERSISTFS_CONFIG = "-C ${WORKDIR}/persist_fsconfig.conf"
MAKEEXT4_MOUNT_OPT = "-a /"

#no-test-bundle ensures reduced size package installation.
#qti-audiopd ensures audiopd is supported by adsp"
#systemd-minimal ensures reduced system size package installation.
DISTRO_FEATURES_append = " no-test-bundle qti-audiopd systemd-minimal"

#qti-cdsp ensures cdsp subsystem is supported.
#wlan ensures wlan functionality is supported.
#wlan-1x1 ensures wlan chip is 1x1, enable it only if wlan is enabled
MACHINE_FEATURES_append = " qti-cdsp wlan wlan-1x1 "

#wlan-perf build wlan driver with perf config
DISTRO_FEATURES_append  = " ${@bb.utils.contains("MACHINE_FEATURES", "wlan", "wlan-perf", "", d)} "

PREFERRED_PROVIDER_virtual/libgles1 = "adreno"
PREFERRED_PROVIDER_virtual/libgles2 = "adreno"
PREFERRED_PROVIDER_virtual/egl      = "adreno"
PREFERRED_VERSION_libdrm = "2.4.83"

# Enable coedump
SYSTEMD_ENABLE_COREDUMP = "1"
SYSTEMD_COREDUMP_PATH = "/var/tmp"

#Enable factory storage
DISTRO_FEATURES_append = "factory-storage"
```

## poky/meta-qti-bsp/conf/machine/qcs403-som2.conf
```bitbake
#@TYPE: Machine
#@NAME: SOM2-QCS403
#@DESCRIPTION: Machine configuration for QTI SOM2-QCS403
require conf/machine/include/qcs40x.inc
# NAND TARGET TO SUPPORT 32-bit kernel
DISTRO = "qsap"
DISTRO_FEATURES += "nand-boot"
DISTRO_FEATURES_NATIVE_append = " nand-boot "

PAGE_SIZE ?= '4096'
USR_IMAGE_BASENAME       = "${BASEMACHINE}-usrfs"
OUTPUT_FILE_FINAL_UBI    = "${DEPLOY_DIR_IMAGE}/${BASEMACHINE}-sysfs.ubi"
# Max supported inodes
EXTRA_IMAGECMD ?= "-N 2048"
#UBINIZE Args
UBINIZE_ARGS ?= "-m 4096 -p 256KiB -s 4096"
#MKUBIFS Args
MKUBIFS_ARGS ?= "-m 4096 -e 253952 -c 2146 -F"

MACHINE_MNT_POINTS = "/firmware /persist /cache /dsp /bt_firmware"

#defconfig to be used for qcs403-som2
KERNEL_CONFIG = "${@['vendor/qcs403-perf_defconfig', 'vendor/qcs403_defconfig'][d.getVar('VARIANT', True) == ('' or 'debug')]}"

#Volume sizes
SYSTEM_VOLUME_SIZE ?= "150MiB"
CACHE_VOLUME_SIZE ?= "81MiB"
SYSTEMRW_VOLUME_SIZE ?= "6MiB"
PERSIST_VOLUME_SIZE ?= "12MiB"
# Formats of root filesystem images.
IMAGE_FSTYPES += "ubi"

#Disable ssd listener
DISTRO_FEATURES_append = " no-ssd-listener-support"

#Disable rpmb listener
DISTRO_FEATURES_append = " no-rpmb-listener-support"

# enable audio as a loadable kernel module
DISTRO_FEATURES_append = " audio-dlkm"
DISTRO_FEATURES_append = " persist-volume"
DISTRO_FEATURES_append = " nand-squashfs"
DEFAULTTUNE = "armv7ahf-neon"
MKUBIFS_PERSIST_ARGS = "-m 4096 -e 253952 -c 2146 -F"
RECOVERY_IMAGE = "0"

KERNEL_IMAGETYPE = "zImage-dtb"

#Need for compiling UEFI for aarch64
require conf/multilib.conf
MULTILIBS = "multilib:lib64"
DEFAULTTUNE_virtclass-multilib-lib64 = "aarch64"

PREFERRED_PROVIDER_virtual/libgles1 = "adreno"
PREFERRED_PROVIDER_virtual/libgles2 = "adreno"
PREFERRED_PROVIDER_virtual/egl      = "adreno"
PREFERRED_VERSION_libdrm = "2.4.83"

QPERM_FILE_pn-start-script-ab-slot-util = "${bindir}/getslotsuffix:0:1000"
QPERM_FILE_pn-system-core = "${sysconfdir}/build.prop:5002:5002"
QPERM_FILE_pn-system-prop = "/build.prop:5002:5002"
QPERM_FILE_pn-alm         = "/persist/data:1000:1000"

#no-test-bundle ensures reduced size package installation.
#qti-audiopd ensures audiopd is supported by adsp"
DISTRO_FEATURES_append = " no-test-bundle qti-audiopd "

#qti-cdsp ensures cdsp subsystem is supported.
#wlan ensures wlan functionality is supported.
#wlan-1x1 ensures wlan chip is 1x1, enable it only if wlan is enabled
MACHINE_FEATURES_append = " qti-cdsp wlan wlan-1x1 "

#wlan-perf build wlan driver with perf config
DISTRO_FEATURES_append  = " ${@bb.utils.contains("MACHINE_FEATURES", "wlan", "wlan-perf", "", d)} "

# Enable coedump
SYSTEMD_ENABLE_COREDUMP = "1"
SYSTEMD_COREDUMP_PATH = "/var/tmp"

DISTRO_FEATURES += "factory-storage"
```
