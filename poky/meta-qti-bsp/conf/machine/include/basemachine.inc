## poky/meta-qti-bsp/conf/machine/sa2150p-nand.conf
```bitbake
#@TYPE: Machine
#@NAME: SA2150P-NAND
#@DESCRIPTION: Machine configuration for QTI SA2150P NAND

require conf/machine/include/qcs40x.inc
require conf/machine/include/sa2150p-eap.inc

MACHINEOVERRIDES =. "sa2150p:"

# Mount points
MACHINE_MNT_POINTS = "/firmware /persist /cache /dsp"

# Kernel Configurations
DEFAULTTUNE = "aarch64"
PAGE_SIZE = '4096'
KERNEL_CONFIG = "${@['vendor/sa2150p-nand-perf_defconfig', 'vendor/sa2150p-nand_defconfig'][d.getVar('VARIANT', True) == ('' or 'debug')]}"
KERNEL_IMAGETYPE = "Image.gz-dtb"
SERIAL_CONSOLES = "115200;ttyMSM0"

# Image names
DEPLOY_DIR_IMAGE_NAND = "${DEPLOY_DIR_IMAGE}"
BOOTIMAGE_TARGET = "${MACHINE}-boot.img"
UBIFS_UBI_IMAGE      = "${MACHINE}-system-ubifs.ubi"
USR_IMAGE_BASENAME  = "${MACHINE}-userdata"
OUTPUT_FILE_PERSIST_UBI   = "${DEPLOY_DIR_IMAGE_NAND}/${MACHINE}-persist.ubi"
OUTPUT_FILE_PERSIST_UBIFS = "${DEPLOY_DIR_IMAGE_NAND}/${MACHINE}-persist.ubifs"
RECOVERYFS_SQUASHFS_UBI_IMAGE = "${DEPLOY_DIR_IMAGE_NAND}/recoveryfs.ubi"
RECOVERYFS_SQUASHFS_IMAGE = "${DEPLOY_DIR_IMAGE_NAND}/recoveryfs.squash"
OUTPUT_FILE_FINAL_SQUASHFS_UBI = "${DEPLOY_DIR_IMAGE_NAND}/system.ubi"
SQUASHFS_SYS_VOLUME = "system.squash"
UBIFS_SYS_VOLUME = "system.ubifs"

# Max supported inodes
EXTRA_IMAGECMD = "-N 2048"
UBINIZE_ARGS = "-m 4096 -p 256KiB -s 4096"
MKUBIFS_ARGS = "-m 4096 -e 253952 -c 2146 -F"
MKUBIFS_PERSIST_ARGS = "-m 4096 -e 253952 -c 2146 -F"

# Volume sizes
SYSTEM_VOLUME_SIZE      = "150MiB"
CACHE_VOLUME_SIZE       = "81MiB"
SYSTEMRW_VOLUME_SIZE    = "6MiB"
PERSIST_VOLUME_SIZE     = "6MiB"
AB_CACHE_VOLUME_SIZE    = "6MiB"
AB_SYSTEM_VOLUME_SIZE   = "100MiB"
AB_PERSIST_VOLUME_SIZE  = "6MiB"
AB_SYSTEMRW_VOLUME_SIZE = "6MiB"
AB_SYSTEM_SQUASHFS_VOLUME_SIZE = "50MiB"

# Format of root filesystem images
IMAGE_FSTYPES += "ubi"

# Enable recovery ubi image generation
RECOVERY_IMAGE_UBI = "1"

PREFERRED_PROVIDER_virtual/libgles1 = "adreno"
PREFERRED_PROVIDER_virtual/libgles2 = "adreno"
PREFERRED_PROVIDER_virtual/egl = "adreno"
PREFERRED_VERSION_iproute2 = "4.4.0"

QPERM_FILE_pn-system-core = "${sysconfdir}/build.prop:5002:5002"
QPERM_FILE_pn-system-prop = "/build.prop:5002:5002"

# Set openssl (1.1.1) as openssl provider
PREFERRED_PROVIDER_openssl          = "openssl"
PREFERRED_VERSION_openssl           = "1.1.1a"
PREFERRED_PROVIDER_openssl-native   = "openssl-native"

# Masked Layers
BBMASK += "meta-qti-audio/recipes-products/images/machine-image.bbappend"
BBMASK += "meta-qti-audio-cal/"
BBMASK += "meta-qti-audio-external/"

BBMASK += "meta-qti-wlan/recipes-products/"
BBMASK += "meta-qti-wlan-prop/recipes-products/"

# Enable coredump
SYSTEMD_ENABLE_COREDUMP = "1"
SYSTEMD_COREDUMP_PATH = "${userfsdatadir}/coredump"

# qti-adsp ensures adsp subsystem is supported
MACHINE_FEATURES_append = " qti-adsp "
# qti-cdsp ensures cdsp subsystem is supported
MACHINE_FEATURES_append = " qti-cdsp "
# can ensures libcanwrapper is supported should be generic
MACHINE_FEATURES_append = " can"
```

## poky/meta-qti-bsp/conf/machine/sa2150p.conf
```bitbake
#@TYPE: Machine
#@NAME: SA2150P
#@DESCRIPTION: Machine configuration for QTI SA2150P

require conf/machine/include/qcs40x.inc
require conf/machine/include/sa2150p-eap.inc

DEFAULTTUNE = "aarch64"

MACHINE_MNT_POINTS = "/firmware /persist /cache /dsp"

SERIAL_CONSOLES = "115200;ttyMSM0"

KERNEL_CONFIG = "${@['vendor/sa2150p-perf_defconfig', 'vendor/sa2150p_defconfig'][d.getVar('VARIANT', True) == ('' or 'debug')]}"

PREFERRED_VERSION_iproute2 = "4.4.0"

USRFS_FSCONFIG = "-C ${WORKDIR}/usrfs_fsconfig.conf"
USR_IMAGE_BASENAME  = "${MACHINE}-usrfs"
MAKEEXT4_MOUNT_OPT = "-a /"

BOOTIMAGE_TARGET = "${MACHINE}-boot.img"
CACHEIMAGE_TARGET = "${MACHINE}-cache.ext4"
PERSISTIMAGE_TARGET = "${MACHINE}-persist.ext4"
RECOVERYIMAGE_TARGET = "${MACHINE}-recoveryfs.ext4"
SYSTEMIMAGE_TARGET = "${MACHINE}-sysfs.ext4"
SYSTEMRWIMAGE_TARGET = "${MACHINE}-systemrw.ext4"
USERDATAIMAGE_TARGET = "${MACHINE}-usrfs.ext4"

# Sizes for EXT4 (in bytes)
SYSTEM_SIZE_EXT4 = "681574400"
SYSTEMRW_SIZE_EXT4 = "8388608"
USERDATA_SIZE_EXT4 = "5000000000"
CACHE_SIZE_EXT4 = "80000000"

# Enable dm-verity feature for non debug builds
DISTRO_FEATURES += "${@bb.utils.contains('VARIANT', 'perf', 'dm-verity', '', d)}"
DISTRO_FEATURES_FILTER_NATIVE += "${@bb.utils.contains('VARIANT', 'perf', 'dm-verity', '', d)}"

# Formats of root filesystem images.
IMAGE_FSTYPES += "ext4"
RECOVERY_IMAGE = "0"

KERNEL_IMAGETYPE = "Image.gz-dtb"
IMAGE_EXT4_EXTRA_OPTIONS = "${@bb.utils.contains('DISTRO_FEATURES','ro-rootfs',' -J -b 4096 ','',d)}"

DISTRO_FEATURES += "persist-image"
DISTRO_FEATURES += "ab-boot-support"
DISTRO_FEATURES_NATIVE += "ab-boot-support"
DISTRO_FEATURES_append = "vipertooth"

PREFERRED_PROVIDER_virtual/libgles1 = "adreno"
PREFERRED_PROVIDER_virtual/libgles2 = "adreno"
PREFERRED_PROVIDER_virtual/egl = "adreno"

QPERM_FILE_pn-start-script-ab-slot-util = "${bindir}/getslotsuffix:0:1000"
QPERM_FILE_pn-system-core = "${sysconfdir}/build.prop:5002:5002"
QPERM_FILE_pn-system-prop = "/build.prop:5002:5002"

BBMASK += "meta-qti-audio/recipes-products/images/machine-image.bbappend"
BBMASK += "meta-qti-audio-cal/"
BBMASK += "meta-qti-audio-external/"
BBMASK += "meta-qti-bt/"

# Enable coredump
SYSTEMD_ENABLE_COREDUMP = "1"
SYSTEMD_COREDUMP_PATH = "${userfsdatadir}/coredump"

# Enable SELinux
DISTRO_FEATURES += "selinux"
DISTRO_FEATURES_FILTER_NATIVE  += "selinux"
DEFAULT_ENFORCING = "enforcing"

# Set openssl (1.1.1) as openssl provider
PREFERRED_PROVIDER_openssl          = "openssl"
PREFERRED_VERSION_openssl           = "1.1.1a"
PREFERRED_PROVIDER_openssl-native   = "openssl-native"

# qti-adsp ensures cdsp subsystem is supported
MACHINE_FEATURES_append = " qti-adsp "
# qti-cdsp ensures cdsp subsystem is supported
MACHINE_FEATURES_append = " qti-cdsp "
# can ensures libcanwrapper is supported should be generic
MACHINE_FEATURES_append = " can"

# Enable early ethernet
DISTRO_FEATURES += "early-eth"

# Enable SDK feature
SDK_IMAGE = "1"
```

## poky/meta-qti-bsp/conf/machine/sa415m.conf
```bitbake
#@TYPE: Machine
#@NAME: SA415M
#@DESCRIPTION: Machine configuration for QTI sa415m

require conf/machine/include/sdxpoorwills.inc

KERNEL_IMAGETYPE = "zImage-dtb"
KERNEL_DTS_NAME = "sdxpoorwills"
KERNEL_BASE = "0x80000000"
KERNEL_TAGS_OFFSET = "0x82000000"

KERNEL_CONFIG ?= "${@['sa415m-perf_defconfig', 'sa415m_defconfig'][d.getVar('VARIANT', True) == ('' or 'debug')]}"

KERNEL_CMD_PARAMS = "noinitrd ro rootwait console=ttyMSM0,115200,n8 androidboot.hardware=qcom msm_rtb.filter=0x37 androidboot.console=ttyMSM0 lpm_levels.sleep_disabled=1  firmware_class.path=/lib/firmware/updates service_locator.enable=1"
KERNEL_CMD_PARAMS_remove = "${@bb.utils.contains_any('VARIANT', 'perf user', 'console=ttyMSM0,115200,n8 androidboot.console=ttyMSM0', '', d)}"

BOOTIMAGE_TARGET = "${MACHINE}-boot.img"

# Volume sizes
SYSTEM_VOLUME_SIZE = "100MiB"
CACHE_VOLUME_SIZE = "15MiB"
SYSTEMRW_VOLUME_SIZE = "6MiB"
PERSIST_VOLUME_SIZE = "6MiB"

# Enable recovery image generation.
RECOVERY_IMAGE ?= "1"

VIRTUAL-RUNTIME_dev_manager = "udev"
VIRTUAL-RUNTIME_init_manager = "systemd"

# Change Image features for systemd.
IMAGE_DEV_MANAGER = "udev"
IMAGE_INIT_MANAGER = "systemd"
IMAGE_INITSCRIPTS = ""

MACHINE_MNT_POINTS = "/firmware /persist /cache"

# Enable coredump
SYSTEMD_ENABLE_COREDUMP = "1"
SYSTEMD_COREDUMP_PATH = "${userfsdatadir}/coredump"

# Enable SDK feature
SDK_IMAGE = "1"

# Enable early USB init
DISTRO_FEATURES_append = " early-usb-init"
DISTRO_FEATURES_append = " cmnlib-preload"
```

## poky/meta-qti-bsp/conf/machine/sdm-generic64.conf
```bitbake
# pull in the image classification.
require conf/machine/include/basemachine.inc

# pull in the system on chip definition
include conf/machine/include/soc-family.inc

# pull in the arm machine definition
require conf/machine/include/arm/arch-armv8.inc

# Pull in security flags
require ${COREBASE}/meta-qti-bsp/conf/distro/include/security_flags.inc

PREFERRED_PROVIDER_virtual/kernel ?= "linux-dummy"

BASEMACHINE ?="sdm-generic64"

KERNEL_CMD_PARAMS ?= "noinitrd ro rootwait console=ttyMSM0,115200,n8 no_console_suspend=1 androidboot.hardware=qcom androidboot.console=ttyMSM0 lpm_levels.sleep_disabled=1 service_locator.enable=1 firmware_class.path=/lib/firmware/updates"

SERIAL_CONSOLE ?= "${@['', '115200 ttyMSM0'][d.getVar('VARIANT', True) == ('' or 'debug')]}"

DISTRO ?= "msm"

#set page size to 4096 as preferred page size.
PAGE_SIZE ?= '4096'

DEFAULTTUNE = "aarch64"

DISTRO_FEATURES_remove = "sysvinit"

DISTRO_FEATURES_append = " systemd"

VIRTUAL-RUNTIME_dev_manager = "udev"

VIRTUAL-RUNTIME_init_manager = "systemd"

# Change Image features for systemd.
IMAGE_DEV_MANAGER = "udev"

IMAGE_INIT_MANAGER = "systemd"

IMAGE_INITSCRIPTS = ""

SYSTEM_SIZE_EXT4 ?= "3221225472"
SYSTEMRW_SIZE_EXT4 ?= "8388608"
USERDATA_SIZE_EXT4 ?= "5000000000"
CACHE_SIZE_EXT4 ?= "65536000"
RECOVERYFS_SIZE_EXT4 ?= "136000000"

# Generate persist image
DISTRO_FEATURES += "persist-image"

IMAGE_FSTYPES += "ext4"
RECOVERY_IMAGE ?= "0"
```

## poky/meta-qti-bsp/conf/machine/sdmsteppe.conf
```bitbake
#@TYPE: Machine
#@NAME: sdmsteppe
#@DESCRIPTION: Machine configuration for QTI sdmsteppe 32bit

require  ${COREBASE}/meta-qti-bsp/conf/machine/sdm-generic32.conf

# Pull in security flags
require ${COREBASE}/meta-qti-bsp/conf/distro/include/security_flags.inc

SOC_FAMILY = "sdm670"

BASEMACHINE = "sdmsteppe"

DEFAULTTUNE = "armv7ahf-neon"

PREFERRED_PROVIDER_virtual/kernel = "linux-msm"
PREFERRED_VERSION_linux-msm = "4.14"
PREFERRED_VERSION_libdrm = "2.4.83"

# Kernel to build for a different arch than default tune
TARGET_KERNEL_ARCH = "aarch64"

KERNEL_DTS_NAME = "sm6150-qrd"
KERNEL_BASE = "0x80000000"
KERNEL_TAGS_OFFSET = "0x81E00000"
KERNEL_IMAGETYPE = "Image-dtb"
KERNEL_CONFIG = "${@['vendor/sdmsteppe-perf_defconfig', 'vendor/sdmsteppe_defconfig'][d.getVar('VARIANT', True) == ('' or 'debug')]}"

# Defined 64bit multilib environment to setup toolchain to compile 64bit kernel
require conf/multilib.conf
MULTILIBS = "multilib:lib64"
DEFAULTTUNE_virtclass-multilib-lib64 = "aarch64"
TARGET_VENDOR_virtclass-multilib-lib64="-oe"

# Enable selinux
DISTRO_FEATURES_append = " selinux"
DEFAULT_ENFORCING = "enforcing"

#Enable verity feature
DISTRO_FEATURES += "dm-verity"

# enable audio as a loadable kernel module
DISTRO_FEATURES_append = " audio-dlkm"

# readonly-rootfs
DISTRO_FEATURES_append = " ro-rootfs"

# Support A/B partition scheme
DISTRO_FEATURES += "ab-boot-support"

# drm driver
MACHINE_FEATURES += "drm"

#Disable journalling for RO rootfs. Set the block size to 4096.
IMAGE_EXT4_EXTRA_OPTIONS = "${@bb.utils.contains('DISTRO_FEATURES','ro-rootfs',' -J -b 4096 ','',d)}"

QPERM_FILE_pn-start-script-ab-slot-util = "${bindir}/getslotsuffix:0:1000"
QPERM_FILE_pn-system-core = "${sysconfdir}/build.prop:5002:5002"
QPERM_FILE_pn-system-prop = "/build.prop:5002:5002"

# Userspace needs below given macro to support libion after kernel 4.12.
TARGET_CFLAGS_append = " -DTARGET_ION_ABI_VERSION=2 "
TARGET_CXXFLAGS_append = " -DTARGET_ION_ABI_VERSION=2 "

PREFERRED_PROVIDER_virtual/libgles1 = "adreno"
PREFERRED_PROVIDER_virtual/libgles2 = "adreno"
PREFERRED_PROVIDER_virtual/egl      = "adreno"
PREFERRED_PROVIDER_openssl          = "openssl10"
PREFERRED_VERSION_openssl10         = "1.0.2q"
PREFERRED_PROVIDER_openssl-native   = "openssl10-native"

MACHINE_MNT_POINTS = "/firmware /persist /cache /dsp /bt_firmware"

# Enable LE Verified Boot
DISTRO_FEATURES_append = " vble"

# Enable coredump
SYSTEMD_ENABLE_COREDUMP = "1"
SYSTEMD_COREDUMP_PATH = "${userfsdatadir}/coredump"

#Uncomment to Enable SNPE wrapper compilation
#DISTRO_FEATURES += "snpe-enable"

#Enable TFlite wrapper compilation
#DISTRO_FEATURES += "tflite-enable"

DISTRO_FEATURES  += "qti-audio"
MACHINE_FEATURES += "qti-audio"
DISTRO_FEATURES  += "qti-camerax"
DISTRO_FEATURES  += "qti-fastcv"
DISTRO_FEATURES  += "qmmf-wayland"
DISTRO_FEATURES  += "qti-qmmf-legacy"
DISTRO_FEATURES  += "qti-qmmf"
DISTRO_FEATURES  += "qti-video"
```

## poky/meta-qti-bsp/conf/machine/sdxpoorwills.conf
```bitbake
#@TYPE: Machine
#@NAME: SDXPOORWILLS
#@DESCRIPTION: Machine configuration for QTI sdxpoorwills

require conf/machine/include/sdxpoorwills.inc

KERNEL_IMAGETYPE = "zImage-dtb"
KERNEL_DTS_NAME = "sdxpoorwills"
KERNEL_BASE = "0x80000000"
KERNEL_TAGS_OFFSET = "0x82000000"

KERNEL_CONFIG ?= "${@['sdxpoorwills-perf_defconfig', 'sdxpoorwills_defconfig'][d.getVar('VARIANT', True) == ('' or 'debug')]}"

KERNEL_CMD_PARAMS = "noinitrd ro rootwait console=ttyMSM0,115200,n8 androidboot.hardware=qcom msm_rtb.filter=0x37 androidboot.console=ttyMSM0 lpm_levels.sleep_disabled=1  firmware_class.path=/lib/firmware/updates service_locator.enable=1"
KERNEL_CMD_PARAMS_remove = "${@bb.utils.contains_any('VARIANT', 'perf user', 'console=ttyMSM0,115200,n8 androidboot.console=ttyMSM0', '', d)}"

# Enable recovery image generation.
RECOVERY_IMAGE ?= "1"

MACHINE_MNT_POINTS = "/firmware /persist /cache"
```

## poky/meta-qti-bsp/conf/machine/sdxprairie.conf
```bitbake
#@TYPE: Machine
#@NAME: SDXPRAIRIE
#@DESCRIPTION: Machine configuration for QTI sdxprairie

require conf/machine/include/sdxprairie.inc

KERNEL_IMAGETYPE = "zImage-dtb"
KERNEL_DTS_NAME = "sdxprairie"
KERNEL_BASE = "0x80000000"
KERNEL_TAGS_OFFSET = "0x82000000"

KERNEL_CONFIG = "${@['sdxprairie-perf_defconfig', 'sdxprairie_defconfig'][d.getVar('VARIANT', True) == ('' or 'debug')]}"

KERNEL_CMD_PARAMS = "noinitrd ro rootwait console=ttyMSM0,115200,n8 androidboot.hardware=qcom msm_rtb.filter=0x237 androidboot.console=ttyMSM0 lpm_levels.sleep_disabled=1 firmware_class.path=/lib/firmware/updates service_locator.enable=1 net.ifnames=0"
KERNEL_CMD_PARAMS_remove = "${@bb.utils.contains_any('VARIANT', 'perf user', 'console=ttyMSM0,115200,n8 androidboot.console=ttyMSM0', '', d)}"

LLVM_VERSION = "6.0"

#Enable audio kernel
DISTRO_FEATURES += "audiodlkm audio-dlkm"

DISTRO_FEATURES_append += " selinux"
DISTRO_FEATURES_append += " cmnlib-preload"
DISTRO_FEATURES_FILTER_NATIVE += " selinux"
DEFAULT_ENFORCING = "enforcing"
MACHINE_MNT_POINTS = "/firmware /persist /cache"
```
