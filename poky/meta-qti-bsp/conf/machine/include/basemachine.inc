## poky/meta-qti-bsp/conf/machine/vt-64.conf
```bitbake
#@TYPE: Machine
#@NAME: VT-64
#@DESCRIPTION: Machine configuration for QTI SOM1-QCS405
require conf/machine/include/qcs40x.inc
# EMMC TARGET TO SUPPORT 64-bit kernel
DISTRO = "qsap"
DEFAULTTUNE = "aarch64"

#boot image
BOOTIMAGE_TARGET = "boot.img"

#EXT4 FILES NAME
CACHEIMAGE_TARGET    = "cache.img"
PERSISTIMAGE_TARGET  = "persist.img"
RECOVERYIMAGE_TARGET = "recoveryfs.img"
SYSTEMIMAGE_TARGET   = "system.img"
SYSTEMRWIMAGE_TARGET = "systemrw.img"
USERDATAIMAGE_TARGET = "usrdata.img"

MACHINE_MNT_POINTS = "/firmware /persist /cache /dsp /bt_firmware"

# Sizes for EXT4 (in bytes)
SYSTEM_SIZE_EXT4 ?= "681574400"
SYSTEMRW_SIZE_EXT4 ?= "8388608"
USERDATA_SIZE_EXT4 ?= "1000000000"
CACHE_SIZE_EXT4 ?= "80000000"

# enable audio as a loadable kernel module
DISTRO_FEATURES_append = " audio-dlkm"
#defconfig to be used for vt-64
KERNEL_CONFIG = "${@['vendor/qcs405-perf_defconfig', 'vendor/qcs405_defconfig'][d.getVar('VARIANT', True) == ('' or 'debug')]}"

#enable selinux
# DISTRO_FEATURES_append = " selinux"
# DEFAULT_ENFORCING = "enforcing"

#Enable dm-verity feature for non debug builds
DISTRO_FEATURES += "${@bb.utils.contains('DEBUG_BUILD', '1', '', 'dm-verity', d)}"

# Formats of root filesystem images.
IMAGE_FSTYPES += "ext4"
RECOVERY_IMAGE = "0"

KERNEL_IMAGETYPE = "Image.gz-dtb"
IMAGE_EXT4_EXTRA_OPTIONS = "${@bb.utils.contains('DISTRO_FEATURES','ro-rootfs',' -J -b 4096 ','',d)}"
DISTRO_FEATURES += "persist-image"
require conf/multilib.conf
MULTILIBS = "multilib:lib32"
DEFAULTTUNE_virtclass-multilib-lib32 = "armv7ahf-neon"
TARGET_VENDOR_virtclass-multilib-lib32="-oe"

PREFERRED_PROVIDER_virtual/libgles1 = "adreno"
PREFERRED_PROVIDER_virtual/libgles2 = "adreno"
PREFERRED_PROVIDER_virtual/egl      = "adreno"
PREFERRED_VERSION_libdrm = "2.4.83"

# Set ab-boot-support feature for native tools as well,
# as some native tools have workflow chnages for AB builds.
DISTRO_FEATURES += "ab-boot-support"
DISTRO_FEATURES_NATIVE_append = " ab-boot-support "

#enable stderror debug for vt devices
PACKAGECONFIG_append_pn-adk-utils = " stderr debug"

QPERM_FILE_pn-start-script-ab-slot-util = "${bindir}/getslotsuffix:0:1000"
QPERM_FILE_pn-system-core = "${sysconfdir}/build.prop:5002:5002"
QPERM_FILE_pn-system-prop = "/build.prop:5002:5002"

PREFERRED_PROVIDER_virtual/wpebackend = "wpebackend-rdk"

# Enable coedump
SYSTEMD_ENABLE_COREDUMP = "1"
SYSTEMD_COREDUMP_PATH = "/var/tmp"

#qti-gpu ensures gpu is supported.
#qti-display ensures display is supported.
#qti-sensors ensures sensors is supported.
#qti-cdsp ensures cdsp subsystem is supported.
#wlan ensures wlan functionality is supported.
#wlan-sdio ensures the second radio with sdio interface exists.
MACHINE_FEATURES_append = " qti-gpu qti-display qti-sensors qti-cdsp wlan wlan-sdio "

#qti-mmparser ensures multimedia parsers are supported.
#qti-audiopd ensures audiopd is supported by adsp.
#wlan-perf build wlan driver with perf config
DISTRO_FEATURES_append  = " qti-mmparser qti-audiopd "

DISTRO_FEATURES_append  = " ${@bb.utils.contains("MACHINE_FEATURES", "qti-gpu", "qti-gfx", "", d)} "
DISTRO_FEATURES_append  = " ${@bb.utils.contains("MACHINE_FEATURES", "wlan", "wlan-perf", "", d)} "

PERSISTFS_CONFIG = "-C ${WORKDIR}/persist_fsconfig.conf"
MAKEEXT4_MOUNT_OPT = "-a /"

#Enable TFlite compilation
DISTRO_FEATURES += "tflite-enable"

#Enable factory storage
DISTRO_FEATURES_append = "factory-storage"
```

## poky/meta-qti-bt/conf/layer.conf
```bitbake
BBFILES += "${LAYERDIR}/recipes/*/*.bb ${LAYERDIR}/recipes/*/*.bbappend ${LAYERDIR}/recipes-*/*/*.bb ${LAYERDIR}/recipes-products/images/*.bbappend"
BBPATH .= ":${LAYERDIR}"
BBFILE_COLLECTIONS += "bt"
LAYERSERIES_COMPAT_bt = "thud"
BBFILE_PRIORITY_bt = "12"
BBFILE_PATTERN_bt := "^${LAYERDIR}/"
```

## poky/meta-qti-camera/conf/layer.conf
```bitbake
BBFILES += "${LAYERDIR}/recipes/*/*.bb ${LAYERDIR}/recipes/*/*.bbappend ${LAYERDIR}/recipes-*/*/*.bb ${LAYERDIR}/recipes-products/images/*.bbappend"
BBPATH .= ":${LAYERDIR}"
BBFILE_COLLECTIONS += "qti_cam"
LAYERSERIES_COMPAT_qti_cam = "thud"
BBFILE_PRIORITY_qti_cam =  "12"
BBFILE_PATTERN_qti_cam := "^${LAYERDIR}/"
```

## poky/meta-qti-core/conf/layer.conf
```bitbake
BBFILES += "${LAYERDIR}/recipes/*/*.bb ${LAYERDIR}/recipes/*/*.bbappend ${LAYERDIR}/recipes-*/*/*.bb ${LAYERDIR}/recipes-products/images/*.bbappend"
BBPATH .= ":${LAYERDIR}"
BBFILE_COLLECTIONS += "qti-core"
BBFILE_PRIORITY_qti-core = "12"
BBFILE_PATTERN_qti-core := "^${LAYERDIR}/"
LAYERSERIES_COMPAT_qti-core = "thud"
```

## poky/meta-qti-data/conf/layer.conf
```bitbake
BBFILES += "${LAYERDIR}/recipes/*/*.bb ${LAYERDIR}/recipes/*/*.bbappend ${LAYERDIR}/recipes-*/*/*.bb ${LAYERDIR}/recipes-products/images/*.bbappend"
BBPATH .= ":${LAYERDIR}"
BBFILE_COLLECTIONS += "msm-data"
LAYERSERIES_COMPAT_msm-data = "thud"
BBFILE_PRIORITY_msm-data = "12"
BBFILE_PATTERN_msm-data := "^${LAYERDIR}/"
```

## poky/meta-qti-display/conf/layer.conf
```bitbake
BBFILES += "${LAYERDIR}/recipes/*/*.bb ${LAYERDIR}/recipes/*/*.bbappend ${LAYERDIR}/recipes-*/*/*.bb ${LAYERDIR}/recipes-products/images/*.bbappend"
BBPATH .= ":${LAYERDIR}"
BBFILE_COLLECTIONS += "qti_display"
LAYERSERIES_COMPAT_qti_display = "thud"
BBFILE_PRIORITY_qti_display = "12"
BBFILE_PATTERN_qti_display := "^${LAYERDIR}/"
```

## poky/meta-qti-drones/conf/layer.conf
```bitbake
BBFILES += "${LAYERDIR}/recipes/*/*.bb ${LAYERDIR}/recipes/*/*.bbappend ${LAYERDIR}/recipes-*/*/*.bb ${LAYERDIR}/recipes-products/images/*.bbappend"
BBPATH .= ":${LAYERDIR}"
BBFILE_COLLECTIONS += "msm"
BBFILE_PRIORITY_msm = "12"
BBFILE_PATTERN_msm := "^${LAYERDIR}/"
```

## poky/meta-qti-qsap/conf/layer.conf
```bitbake
BBFILES += "${LAYERDIR}/recipes/*/*.bb ${LAYERDIR}/recipes/*/*.bbappend ${LAYERDIR}/recipes-*/*/*.bb ${LAYERDIR}/recipes-*/*/*.bbappend"
BBPATH .= ":${LAYERDIR}"
BBFILE_COLLECTIONS += "qsap"
BBFILE_PATTERN_qsap := "^${LAYERDIR}/"

# msm = meta-qti-bsp
LAYERDEPENDS_qsap = "msm"
```

## poky/meta-qti-wlan/conf/layer.conf
```bitbake
BBFILES += "${LAYERDIR}/recipes/*/*.bb ${LAYERDIR}/recipes/*/*.bbappend ${LAYERDIR}/recipes-*/*/*.bb ${LAYERDIR}/recipes-products/images/*.bbappend"
BBPATH .= ":${LAYERDIR}"
BBFILE_COLLECTIONS += "wlan"
LAYERSERIES_COMPAT_wlan = "thud"
BBFILE_PRIORITY_wlan = "12"
BBFILE_PATTERN_wlan := "^${LAYERDIR}/"
```

## poky/meta-user-managemement/conf/layer.conf
```bitbake
# We have a conf and classes directory, add to BBPATH
BBPATH .= ":${LAYERDIR}"

# We have recipes-* directories, add to BBFILES
BBFILES += "${LAYERDIR}/recipes-*/*/*.bb ${LAYERDIR}/recipes-*/*/*.bbappend"

BBFILE_COLLECTIONS += "user-management"
BBFILE_PATTERN_user-management = "^${LAYERDIR}/"
BBFILE_PRIORITY_user-management = "1"

# This should only be incremented on significant changes that will
# cause compatibility issues with other layers
LAYERVERSION_user-management = "1"

LAYERDEPENDS_user-management = "core"
```

## poky/old-meta-qti-audio/conf/layer.conf
```bitbake
BBFILES += "${LAYERDIR}/recipes/*/*.bb ${LAYERDIR}/recipes/*/*.bbappend ${LAYERDIR}/recipes-*/*/*.bb ${LAYERDIR}/recipes-*/*/*.bbappend"
BBPATH .= ":${LAYERDIR}"
BBFILE_COLLECTIONS += "audio"
BBFILE_PRIORITY_audio = "12"
BBFILE_PATTERN_audio := "^${LAYERDIR}/"
```
