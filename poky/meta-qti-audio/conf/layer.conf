## poky/meta-qti-audio/conf/layer.conf
```bitbake
BBFILES += "${LAYERDIR}/recipes/*/*.bb ${LAYERDIR}/recipes/*/*.bbappend ${LAYERDIR}/recipes-*/*/*.bb ${LAYERDIR}/recipes-*/*/*.bbappend"
BBPATH .= ":${LAYERDIR}"
BBFILE_COLLECTIONS += "audio"
LAYERSERIES_COMPAT_audio = "thud"
BBFILE_PRIORITY_audio = "20"
BBFILE_PATTERN_audio := "^${LAYERDIR}/"
```

## poky/meta-qti-auto/conf/layer.conf
```bitbake
BBFILES += "${LAYERDIR}/recipes/*/*.bb ${LAYERDIR}/recipes/*/*.bbappend ${LAYERDIR}/recipes-*/*/*.bb ${LAYERDIR}/recipes-products/images/*.bbappend"
BBPATH .= ":${LAYERDIR}"
BBFILE_COLLECTIONS += "auto"
LAYERSERIES_COMPAT_auto = "thud"
BBFILE_PRIORITY_auto = "12"
BBFILE_PATTERN_auto := "^${LAYERDIR}/"
```

## poky/meta-qti-bsp/conf/distro/auto.conf
```bitbake
BASEDISTRO ?= "mdm"

require conf/distro/mdm.conf

DISTRO_NAME = "auto"
DISTROOVERRIDES =. "${BASEMACHINE}-auto:"

PRODUCT = "auto"

# Enable early ethernet
DISTRO_FEATURES += "early-eth"

# Enable SELinux
DISTRO_FEATURES += "selinux"
DISTRO_FEATURES_FILTER_NATIVE  += "selinux"
DEFAULT_ENFORCING = "enforcing"

# Enable openavb
DISTRO_FEATURES += "openavb"

# Enable FS HMS
DISTRO_FEATURES += "fs_hms_support"

# Enable TelSdk
DISTRO_FEATURES += "qti-telux"

# Use systemd init manager.
DISTRO_FEATURES_remove = "sysvinit"
DISTRO_FEATURES_append = " systemd"
DISTRO_FEATURES_BACKFILL_CONSIDERED += "sysvinit"

INCOMPATIBLE_LICENSE += "GPL-3.0 LGPL-3.0 AGPL-3.0"
WHITELIST_GPL-3.0 += "bash coreutils gawk gdb gdbm gettext m4 readline findutils grep elfutils"
PACKAGE_EXCLUDE += "bash gawk gdbm gettext m4 readline elfutils"
```

## poky/meta-qti-bsp/conf/distro/batcam.conf
```bitbake
# batcam is a derivative of concam.
BASEDISTRO ?= "concam"
require conf/distro/concam.conf

DISTRO_NAME = "batcam"
DISTROOVERRIDES =. "batcam:"

PRODUCT = "batcam"

KERNEL_CONFIG = "${@['msm8953-batcam-perf_defconfig', 'msm8953-batcam_defconfig'][d.getVar('VARIANT', True) == ('' or 'debug')]}"

# Hibernation Support
KERNEL_CMD_PARAMS_append = " resume=/dev/mmcblk0p49 resumewait no_console_suspend=1 "
KERNEL_IMAGETYPE = "Image-dtb"
```

## poky/meta-qti-bsp/conf/distro/concam.conf
```bitbake
BASEDISTRO ?= "msm"
require conf/distro/msm.conf

DISTRO_NAME = "concam"
DISTROOVERRIDES =. "concam:"

PRODUCT ?= "concam"
```

## poky/meta-qti-bsp/conf/distro/drone.conf
```bitbake
BASEDISTRO ?= "msm"
require conf/distro/msm.conf

DISTRO_NAME = "drone"
DISTROOVERRIDES =. "drone:"

PRODUCT = "drone"
```

## poky/meta-qti-bsp/conf/distro/include/base.inc
```bitbake
#############################################################################
#@COMMENT: This distribution configuration defines an OE Linux based
#@COMMENT: distribution. The matching buildable image target (machine-image)
#@COMMENT: basically consists of: libc, busybox, udev, sysv init, and a few
#@COMMENT: init scripts for running up the system on qti chipsets.
#############################################################################
BASEDISTRO ??= ""

# Add BASEDISTRO to overrides
DISTROOVERRIDES =. "${@['', '${BASEDISTRO}:']['${BASEDISTRO}' != '']}"

# DISTRO FEATURE SELECTION
MICRO_GOLD ?= "ld-is-gold"
MICRO_GOLD_apq8017 = ""

USE_DEVFS = "0"

# Use Debian naming scheme for library (.so) files
INHERIT += "recipe_sanity"

# TOOLCHAIN
PREFERRED_VERSION_autoconf = "2.68"
ARM_INSTRUCTION_SET       ?= "arm"

##################################################################
# Optimization flags.
##################################################################
COMMON_OPTIMIZATION = " \
  -Wa,--noexecstack -fexpensive-optimizations \
  -frename-registers -ftree-vectorize \
  -finline-functions -finline-limit=64 \
  -Wno-error=maybe-uninitialized -Wno-error=unused-result \
  "

FULL_OPTIMIZATION         = "-O2 -fomit-frame-pointer ${COMMON_OPTIMIZATION} "
DEBUG_OPTIMIZATION_append = " ${COMMON_OPTIMIZATION} "

# NLS
USE_NLS = "no"
USE_NLS_glib-2.0 = "yes"
USE_NLS_glib-2.0-native = "yes"
USE_NLS_gcc-cross = "no"

# Disable GIO module cache creation
GIO_MODULE_PACKAGES=""

# Disable binary locale generation
ENABLE_BINARY_LOCALE_GENERATION = "0"

#Allow library symlinks to exist alongside soname files
PACKAGE_SNAP_LIB_SYMLINKS = "0"

# Don't install ldconfig and associated gubbins
USE_LDCONFIG = "0"
LDCONFIGDEPEND = ""
COMMERCIAL_LICENSE_DEPENDEES = ""

PRODUCT ??= "base"

# Retain existing directory structure for msm or mdm distro images.
# Append variants like '-perf', '-user' etc to deploy dir.
DEPLOY_NAME_BASE = "${MACHINE}${@bb.utils.contains_any('DISTRO', 'msm mdm auto auto-eap-nand', '', '-' + d.getVar('DISTRO'), d)}"
DEPLOY_NAME = "${DEPLOY_NAME_BASE}${@['-' + d.getVar('VARIANT', True), ''][d.getVar('VARIANT', True) == ('' or 'debug')]}"
DEPLOY_DIR_IMAGE = "${DEPLOY_DIR}/images/${DEPLOY_NAME}"

# Add qti custom permissions
USERADDEXTENSION = "qpermissions"
```

## poky/meta-qti-bsp/conf/distro/include/security_flags.inc
```bitbake
# Pull in the default security flags
require ${COREBASE}/meta/conf/distro/include/security_flags.inc

# Modify the primary security flag definitions of yocto
# _FORTIFY_SOURCE requires -O1 or higher, otherwise results in a compiler warning.
SECURITY_PIE_CFLAGS = "-fstack-protector-strong -pie -fPIE -D_FORTIFY_SOURCE=2 -Wa,--noexecstack ${SECURITY_STRINGFORMAT}"

# For usage by packages which needs position independent code that can be linked into shared libraires.
SECURITY_PIC_CFLAGS = "-fstack-protector-strong -fPIC -D_FORTIFY_SOURCE=2 -Wa,--noexecstack ${SECURITY_STRINGFORMAT}"

SECURITY_CFLAGS = "${SECURITY_PIE_CFLAGS}"
SECURITY_LDFLAGS = "-Wl,-z,relro,-z,now,-z,noexecstack"

# edk2
SECURITY_CFLAGS_pn-edk2 = "-pie -fpie -Wa,--noexecstack"

#
### PACKAGES to use -fPIC in security flags instead of -fPIE
#
# GPS OSS packages
SECURITY_CFLAGS_pn-gps-utils = "${SECURITY_PIC_CFLAGS}"
SECURITY_CFLAGS_pn-loc-hal = "${SECURITY_PIC_CFLAGS}"
SECURITY_CFLAGS_pn-loc-core = "${SECURITY_PIC_CFLAGS}"
SECURITY_CFLAGS_pn-loc-api-v02 = "${SECURITY_PIC_CFLAGS}"
SECURITY_CFLAGS_pn-loc-ds = "${SECURITY_PIC_CFLAGS}"
SECURITY_CFLAGS_pn-loc-net-iface = "${SECURITY_PIC_CFLAGS}"
SECURITY_CFLAGS_pn-location-api = "${SECURITY_PIC_CFLAGS}"
SECURITY_CFLAGS_pn-loc-base-util = "${SECURITY_PIC_CFLAGS}"
SECURITY_CFLAGS_pn-loc-mq-client = "${SECURITY_PIC_CFLAGS}"
SECURITY_CFLAGS_pn-izat-core = "${SECURITY_PIC_CFLAGS}"
SECURITY_CFLAGS_pn-lowi-client = "${SECURITY_PIC_CFLAGS}"
SECURITY_CFLAGS_pn-lbs-core = "${SECURITY_PIC_CFLAGS}"
SECURITY_CFLAGS_pn-drplugin-client = "${SECURITY_PIC_CFLAGS}"
SECURITY_CFLAGS_pn-drplugin = "${SECURITY_PIC_CFLAGS}"
SECURITY_CFLAGS_pn-ulp2 = "${SECURITY_PIC_CFLAGS}"
SECURITY_CFLAGS_pn-location-flp = "${SECURITY_PIC_CFLAGS}"
SECURITY_CFLAGS_pn-location-service = "${SECURITY_PIC_CFLAGS}"
SECURITY_CFLAGS_pn-loc-glue = "${SECURITY_PIC_CFLAGS}"
SECURITY_CFLAGS_pn-location-batching = "${SECURITY_PIC_CFLAGS}"
SECURITY_CFLAGS_pn-location-geofence = "${SECURITY_PIC_CFLAGS}"

# General purpose OSS packages
SECURITY_CFLAGS_pn-gtest = "${SECURITY_PIC_CFLAGS}"
SECURITY_CFLAGS_pn-go-runtime = "${SECURITY_PIC_CFLAGS}"
SECURITY_CFLAGS_pn-binder  = "${SECURITY_PIC_CFLAGS}"
SECURITY_CFLAGS_pn-libcutils  = "${SECURITY_PIC_CFLAGS}"
SECURITY_CFLAGS_pn-liblog  = "${SECURITY_PIC_CFLAGS}"
SECURITY_CFLAGS_pn-av-frameworks  = "${SECURITY_PIC_CFLAGS}"
SECURITY_CFLAGS_pn-libbase = "${SECURITY_PIC_CFLAGS}"
# libutils needs -fPIC
SECURITY_CFLAGS_pn_libutils = "${SECURITY_PIC_CFLAGS}"

# BT OSS packages
SECURITY_CFLAGS_pn-event-observer = "${SECURITY_PIC_CFLAGS}"
SECURITY_CFLAGS_pn-data-items = "${SECURITY_PIC_CFLAGS}"
SECURITY_CFLAGS_pn-bt-property = "${SECURITY_PIC_CFLAGS}"
SECURITY_CFLAGS_pn-bt-app = "${SECURITY_PIC_CFLAGS}"
SECURITY_CFLAGS_pn-libbt-vendor = "${SECURITY_PIC_CFLAGS}"
SECURITY_CFLAGS_pn-fluoride = "${SECURITY_PIC_CFLAGS}"

# MM packages
SECURITY_CFLAGS_pn-display-hal = "${SECURITY_PIC_CFLAGS}"
SECURITY_CFLAGS_pn-media = "${SECURITY_PIC_CFLAGS}"
SECURITY_CFLAGS_pn-lib32-media = "${SECURITY_PIC_CFLAGS}"
SECURITY_CFLAGS_pn-qmmf-sdk = "${SECURITY_PIC_CFLAGS}"
SECURITY_CFLAGS_pn-lib32-qmmf-sdk = "${SECURITY_PIC_CFLAGS}"

#
### PACKAGES which can't compile with _FORTIFY_SOURCE
#
SECURITY_CFLAGS_remove_pn-ebtables = "-D_FORTIFY_SOURCE=2"

#
### PACKAGES which can't compile with security format strings check
#
SECURITY_CFLAGS_remove_pn-audiohal = "${SECURITY_STRINGFORMAT}"
SECURITY_CFLAGS_remove_pn-setools = "${SECURITY_STRINGFORMAT}"
```

## poky/meta-qti-bsp/conf/distro/mdm-kernel-4.9.conf
```bitbake
BASEDISTRO ?= "mdm"
require conf/distro/mdm.conf

DISTRO_NAME = "mdm-kernel-4.9"
DISTROOVERRIDES =. "mdm-kernel-4.9:"

PRODUCT = "mdm-kernel-4.9"
PREFERRED_VERSION_linux-msm = "4.9"
KERNEL_CMD_PARAMS = "noinitrd ro console=ttyMSM0,115200,n8 androidboot.hardware=qcom ehci-hcd.park=3 msm_rtb.filter=0x37 lpm_levels.sleep_disabled=1 earlycon=msm_serial_dm,0x78b3000"
KERNEL_CMD_PARAMS_remove = "${@bb.utils.contains_any('VARIANT', 'perf user', 'console=ttyMSM0,115200,n8', '', d)}"
SERIAL_CONSOLE = "${@['', '115200 ttyMSM0'][d.getVar('VARIANT', True) == ('' or 'debug')]}"
```

## poky/meta-qti-bsp/conf/distro/mincam.conf
```bitbake
# mincam is a derivative of concam.
BASEDISTRO ?= "concam"
require conf/distro/concam.conf

DISTRO_NAME = "mincam"
DISTROOVERRIDES =. "mincam:"

PRODUCT = "mincam"
```

## poky/meta-qti-bsp/conf/distro/nad.conf
```bitbake
BASEDISTRO ?= "auto"
require conf/distro/auto.conf

DISTRO_NAME = "nad-core"

PRODUCT = "auto"

# DM-Verity feature enabled/disabled under this distro. Uncomment to enable DM-Verity
#DISTRO_FEATURES += "dm-verity"

# Enable dm-verity working with avb feature in initramfs or/and in root system
# For initramfs, it also need to enable the distro feature of "initramfs"
DISTRO_FEATURES += "nad-avb"

# enable squahfs
DISTRO_FEATURES += "nand-squashfs"

DISTRO_FEATURES += "ab-boot-support"
DISTRO_FEATURES_NATIVE += "ab-boot-support"

# enable nand-ab
DISTRO_FEATURES += "nand-ab"

# NAD related partition changes are enabled under this distro
DISTRO_FEATURES += "nad-prod"

# enable modem-volume
DISTRO_FEATURES_append = " modem-volume"

# telaf specific features
DISTRO_FEATURES += "nad-telaf"

# Limiting squashfs rootfs size to 70MiB (size should be multiple of LEB, LEB is 253952 bytes)
SYSTEM_SQUASHFS_VOLUME_SIZE ?= "73646080"

CACHE_VOLUME_SIZE = "10MiB"

# Image names
UBIFS_UBI_IMAGE      = "${MACHINE}-sysfs-ubifs.ubi"
OUTPUT_FILE_FINAL_SQUASHFS_UBI = "${DEPLOY_DIR_IMAGE_NAND}/${MACHINE}-sysfs.ubi"
SQUASHFS_SYS_VOLUME = "system.squash"
RECOVERYFS_SQUASHFS_UBI_IMAGE = "${DEPLOY_DIR_IMAGE_NAND}/${MACHINE}-recoveryfs.ubi"
RECOVERYFS_SQUASHFS_IMAGE = "${DEPLOY_DIR_IMAGE_NAND}/recoveryfs.squash"
RECOVERYFS_UBIFS_UBI_IMAGE = "${DEPLOY_DIR_IMAGE_NAND}/${MACHINE}-recoveryfs-ubifs.ubi"

DISTRO_FEATURES_append = " nad-prod-test"
# Bundle initramfs image to kernel image
DISTRO_FEATURES += "initramfs"

DISTRO_FEATURES_NATIVESDK_append = " nad-prod-sdk nad-avb"

# Enable ZRAM as swap on RAM
DISTRO_FEATURES += "zram"

# Enable streaming update
DISTRO_FEATURES += "nad-stream-update"

# Enalbe Full Disc Encryption (FDE)
DISTRO_FEATURES += "nad-fde"

DISTRO_FEATURES_NATIVESDK_append = " nad-prod-sdk nad-avb nad-fde"

DISTRO_FEATURES_append = " nad-prod-test"

PREFERRED_RPROVIDER_libdevmapper = "${@bb.utils.contains('DISTRO_FEATURES', 'nad-prod', 'lvm2', '', d)}"
```

## poky/meta-qti-bsp/conf/distro/psm.conf
```bitbake
BASEDISTRO ?= "psm"
require conf/distro/mdm.conf

DISTRO_NAME = "psm"
DISTROOVERRIDES =. "psm:"

PRODUCT = "psm"

KERNEL_DEFCONFIG = "mdm9607-128mb-perf_defconfig"
```

## poky/meta-qti-bsp/conf/distro/qpermissions.conf
```bitbake
USERADD_PACKAGES ?= "${PN}"

USERADD_PARAM_${PN} ?= 	" \
			-u 5002 -U leprop; \
			-u 1000 -U system; \
			-u 1001 -U radio; \
			-G leprop -u 1002 -U bluetooth; \
			-u 1003 -U graphics; \
			-u 1004 -g input input; \
			-G diag,system -u 1005 -g audio audio; \
			-G inet,system,leprop -u 1006 -U camera; \
			-u 1010 -U wifi; \
			-u 1013 -U media; \
			-u 1036 -U logd; \
			-u 2000 -U adb; \
			-G diag,inet,system,leprop -u 3011 -U sensors; \
			-u 4000 -U apps; \
			-u 9999 -U nobody; \
			-G audio,camera,system,leprop,video -u 5000 -U qmmfsvr; \
			-G audio,camera,input,system,inet,leprop,video -u 5001 -U qmmfwebsvr; \
			-G audio,camera,input,system,inet,leprop,video -u 5003 -U ipcwebsvr; \
			-u 4021 -U locclient; \
			-G system,locclient -u 1021 -U gps; \
			-G system,diag,radio -u 4023 -U mcm; \
			-u 3014 -U powermgr; \
                        -u 3015 -U ubi; \
			-u 3016 -U vnw; \
			-u 2906 -U qrtr; \
			-u 1053 -U c2c; \
			"

GROUPADD_PARAM_${PN} ?=	" \
                        -g 2901 kmsg; \
			-g 3004 net_raw; \
			-g 3005 net_admin; \
			-g 3009 readproc; \
			-g 3010 wakelock; \
			-g 3013 qwes; \
			"
```

## poky/meta-qti-bsp/conf/distro/qsap.conf
```bitbake
BASEDISTRO ?= "msm"
require conf/distro/msm.conf

DISTRO_NAME = "qsap"
DISTROOVERRIDES =. "qsap:"

PRODUCT = "qsap"

# fbdev driver
DISTRO_FEATURES += "fbdev"
```

## poky/meta-qti-bsp/conf/distro/robot-pronto.conf
```bitbake
BASEDISTRO ?= "robot-som"
require conf/distro/robot-som.conf

DISTRO_NAME = "robot-pronto"
DISTROOVERRIDES =. "robot-pronto:"

PRODUCT = "robot-som"
```

## poky/meta-qti-bsp/conf/distro/robot-rome.conf
```bitbake
BASEDISTRO ?= "robot-som"
require conf/distro/robot-som.conf

DISTRO_NAME = "robot-rome"
DISTROOVERRIDES =. "robot-rome:"

PRODUCT = "robot-som"
```

## poky/meta-qti-bsp/conf/distro/robot-som-ros.conf
```bitbake
BASEDISTRO ?= "robot-som"
require conf/distro/robot-som.conf
DISTRO_NAME = "robot-som-ros"
DISTROOVERRIDES =. "robot-som-ros:"

PRODUCT = "robot-som"

#Ros needs larger system size
SYSTEM_SIZE_EXT4 = "998860800"
RECOVERY_IMAGE = "0"

PREFERRED_VERSION_v4l-utils = "1.6.2"

KERNEL_DTS_NAME = "*8*09"

KERNEL_CMD_PARAMS = "noinitrd ro console=ttyMSM0,115200,n8 androidboot.hardware=qcom ehci-hcd.park=3 msm_rtb.filter=0x37 lpm_levels.sleep_disabled=1 rootwait androidboot.bootdevice=7824900.sdhci mem=512M"

PREFERRED_VERSION_linux-msm = "4.9"

SERIAL_CONSOLE = "115200 ttyMSM0"
```

## poky/meta-qti-bsp/conf/distro/robot-som.conf
```bitbake
BASEDISTRO ?= "msm"
require conf/distro/msm.conf
DISTRO_NAME = "robot-som"
DISTROOVERRIDES =. "robot-som:"

PRODUCT = "robot-som"

KERNEL_DTS_NAME = "*8*09"

KERNEL_CMD_PARAMS = "noinitrd ro console=ttyMSM0,115200,n8 androidboot.hardware=qcom ehci-hcd.park=3 msm_rtb.filter=0x37 lpm_levels.sleep_disabled=1 rootwait androidboot.bootdevice=7824900.sdhci mem=512M"

KERNEL_CMD_PARAMS_remove = "${@bb.utils.contains_any('VARIANT', 'perf user', 'console=ttyMSM0,115200,n8', '', d)}"

PREFERRED_VERSION_linux-msm = "4.9"

# enable audio as a loadable kernel module
DISTRO_FEATURES_append = " audio-dlkm"

SERIAL_CONSOLE = "${@['115200 ttyMSM0', ''][d.getVar('VARIANT', True) == ('perf')]}"

DISTRO_FEATURES_append = " ab-boot-support"
```

## poky/meta-qti-bsp/conf/distro/robot.conf
```bitbake
BASEDISTRO ?= "msm"
require conf/distro/msm.conf

DISTRO_NAME = "robot"
DISTROOVERRIDES =. "robot:"

PRODUCT ?= "robot"

PREFERRED_VERSION_v4l-utils = "1.6.2"
```
