## poky/meta-qti-bsp/conf/machine/apq8098.conf
```bitbake
#@TYPE: Machine
#@NAME: APQ8098
#@DESCRIPTION: Machine configuration for QTI MTP with APQ8098

require conf/machine/include/apq8098.inc

KERNEL_IMAGETYPE = "Image.gz-dtb"
KERNEL_DTS_NAME = "msmcobalt"
KERNEL_BASE = "0x80000000"
KERNEL_TAGS_OFFSET = "0x81900000"

KERNEL_CONFIG = "${@['msmcortex_mediabox-perf_defconfig', 'msmcortex_mediabox_defconfig'][d.getVar('VARIANT', True) == ('' or 'debug')]}"

KERNEL_CMD_PARAMS = "noinitrd rw rootwait console=ttyMSM0,115200,n8 no_console_suspend=1 earlycon=msm_serial_dm,0xc1b0000 androidboot.hardware=qcom androidboot.console=ttyMSM0 service_locator.enable=1 sched_enable_hmp=1 sched_enable_power_aware=1 ehci-hcd.park=3 msm_rtb.filter=0x37 lpm_levels.sleep_disabled=1 root=/dev/sde20 rootfstype=ext4 earlyprintk"
KERNEL_CMD_PARAMS_remove = "${@bb.utils.contains_any('VARIANT', 'perf user', 'console=ttyMSM0,115200,n8 androidboot.console=ttyMSM0', '', d)}"

#enable selinux
DISTRO_FEATURES_append=" selinux"
DEFAULT_ENFORCING = "permissive"

PREFERRED_PROVIDER_virtual/libgles1  = "adreno"
PREFERRED_PROVIDER_virtual/libgles2  = "adreno"
PREFERRED_PROVIDER_virtual/egl = "adreno"
```

## poky/meta-qti-bsp/conf/machine/genericarmv8-64.conf
```bitbake
#@TYPE: Machine
#@NAME: GENERICARMv8-64
#@DESCRIPTION: Machine configuration for QTI MTP with GENERICARMv8-64

require conf/machine/include/genericarmv8-64.inc

KERNEL_IMAGETYPE = "Image.gz-dtb"
KERNEL_DTS_NAME = "cvm"
KERNEL_BASE = "0xA0000000"
KERNEL_TAGS_OFFSET = "0xA3200000"
KERNEL_CONFIG = "${@['okl4_virtual_platform_sdm670_vm_defconfig', 'okl4_virtual_platform_sdm670_vm_defconfig'][d.getVar('VARIANT', True) == ('' or 'debug')]}"
KERNEL_CMD_PARAMS = "console=ttyV1 root=/dev/vblock0 rootfstype=ext4 rootwait"

DISTRO_FEATURES_append = " ro-rootfs"
```

## poky/meta-qti-bsp/conf/machine/include/apq8053.inc
```bitbake
BASEMACHINE ?= "apq8053"
require conf/machine/include/basemachine.inc

SOC_FAMILY ?= "msm8953"
include conf/machine/include/soc-family.inc

# Pull in security flags
require ${COREBASE}/meta-qti-bsp/conf/distro/include/security_flags.inc

require conf/machine/include/arm/arch-armv8.inc

PREFERRED_PROVIDER_virtual/kernel = "linux-msm"
PREFERRED_VERSION_linux-msm = "4.9"

PREFERRED_PROVIDER_virtual/egl ?= "adreno"
PREFERRED_PROVIDER_virtual/libgles1 ?= "adreno"
PREFERRED_PROVIDER_virtual/libgles2 ?= "adreno"

MACHINE_DISPLAY_WIDTH_PIXELS ?= "480"
MACHINE_DISPLAY_HEIGHT_PIXELS ?= "640"

SERIAL_CONSOLE ?= "${@['', '115200 ttyMSM0'][d.getVar('VARIANT', True) == ('' or 'debug')]}"

DISTRO ?= "msm"

# Change default jpeg provider to turbo jpeg
PREFERRED_PROVIDER_jpeg = "libjpeg-turbo"

# iproute2 bump version to 4.1.1
PREFERRED_VERSION_iproute2 = "4.1.1"

DISTRO_FEATURES += "persist-image"

MACHINE_FEATURES += "kernel26 keyboard"

PAGE_SIZE ?= '4096'

# Max supported inodes
EXTRA_IMAGECMD ?= "-N 2048"

MACHINE_MNT_POINTS = "/firmware /persist /cache /dsp"

# Sizes for EXT4 (in bytes)
SYSTEM_SIZE_EXT4 ?= "536870912"
SYSTEMRW_SIZE_EXT4 ?= "8388608"
USERDATA_SIZE_EXT4 ?= "1048576000"
CACHE_SIZE_EXT4 ?= "262144000"
RECOVERYFS_SIZE_EXT4 ?= "136000000"

#Enable SDK feature
SDK_IMAGE ?= "1"

#Enable Recovery image generation
RECOVERY_IMAGE ?= "0"

# Formats of root filesystem images.
IMAGE_FSTYPES += "ext4"

#Extra fsconfig related options for ota package generator scripts.
OTA_EXTRA_OPTS ?= "1"

# Support A/B schema for eMMC partitions
DISTRO_FEATURES_append = " ab-boot-support"

# Enable face recognition support
DISTRO_FEATURES_append = " face-recognition"

# Enable LE Verified Boot
DISTRO_FEATURES_append = " vble"
```

## poky/meta-qti-bsp/conf/machine/include/apq8096.inc
```bitbake
BASEMACHINE ?= "apq8096"
require conf/machine/include/basemachine.inc

SOC_FAMILY ?= "msm8996"
include conf/machine/include/soc-family.inc

# Pull in security flags
require ${COREBASE}/meta-qti-bsp/conf/distro/include/security_flags.inc

require conf/machine/include/arm/arch-armv8.inc

PREFERRED_PROVIDER_virtual/kernel = "linux-msm"
PREFERRED_VERSION_linux-msm = "3.18"

MACHINE_DISPLAY_WIDTH_PIXELS ?= "480"
MACHINE_DISPLAY_HEIGHT_PIXELS ?= "640"

SERIAL_CONSOLE ?= "${@['', '115200 ttyHSL0'][d.getVar('VARIANT', True) == ('' or 'debug')]}"

DISTRO ?= "msm"

DISTRO_FEATURES += "persist-image"

MACHINE_FEATURES += "kernel26 keyboard"

PAGE_SIZE ?= '4096'

# Max supported inodes
EXTRA_IMAGECMD ?= "-N 2048"

# Sizes for EXT4 (in bytes)
SYSTEM_SIZE_EXT4 ?= "3000000000"
USERDATA_SIZE_EXT4 ?= "5000000000"
CACHE_SIZE_EXT4 ?= "65536000"
RECOVERYFS_SIZE_EXT4 ?= "136000000"

# Multilib configuration
# This sets any packages preprended with lib32- to be built with
# the armv7a tuning (32 bit) instead of 64-bit aarch64.
require conf/multilib.conf
MULTILIBS = "multilib:lib32"
DEFAULTTUNE_virtclass-multilib-lib32 = "armv7a-neon"
TARGET_VENDOR_virtclass-multilib-lib32="-oe"

#Enable SDK feature
SDK_IMAGE ?= "1"

#Enable Recovery image generation
RECOVERY_IMAGE ?= "1"

# Formats of root filesystem images.
IMAGE_FSTYPES += "ext4"
```

## poky/meta-qti-bsp/conf/machine/include/apq8098.inc
```bitbake
BASEMACHINE ?= "apq8098"
require conf/machine/include/basemachine.inc

SOC_FAMILY ?= "msmcobalt"
include conf/machine/include/soc-family.inc

# Pull in security flags
require ${COREBASE}/meta-qti-bsp/conf/distro/include/security_flags.inc

require conf/machine/include/arm/arch-armv8.inc

PREFERRED_PROVIDER_virtual/kernel = "linux-msm"
PREFERRED_VERSION_linux-msm = "4.4"

MACHINE_DISPLAY_WIDTH_PIXELS ?= "480"
MACHINE_DISPLAY_HEIGHT_PIXELS ?= "640"

SERIAL_CONSOLE ?= "${@['', '115200 ttyMSM0'][d.getVar('VARIANT', True) == ('' or 'debug')]}"

DISTRO ?= "msm"

PREFERRED_VERSION_weston ?= "1.1.9%"

MACHINE_FEATURES += "kernel26 keyboard"

# drm driver
MACHINE_FEATURES += "drm"

PAGE_SIZE ?= '4096'

# Max supported inodes
EXTRA_IMAGECMD ?= "-N 2048"

# Sizes for EXT4 (in bytes)
SYSTEM_SIZE_EXT4 ?= "3000000000"
USERDATA_SIZE_EXT4 ?= "5000000000"
CACHE_SIZE_EXT4 ?= "65536000"
RECOVERYFS_SIZE_EXT4 ?= "136000000"

# Multilib configuration
# This sets any packages preprended with lib32- to be built with
# the armv7a tuning (32 bit) instead of 64 bit aarch.
require conf/multilib.conf
MULTILIBS = "multilib:lib32"
DEFAULTTUNE_virtclass-multilib-lib32 = "armv7a-neon"
TARGET_VENDOR_virtclass-multilib-lib32="-oe"
# Formats of root filesystem images.
IMAGE_FSTYPES += "ext4"
python __anonymous () {
    if (d.getVar('DEBUG', True) == '1'):
        d.setVar('DEBUG_BUILD', '1')
        d.setVar('INHIBIT_SYSROOT_STRIP', '1')
        d.appendVar('EXTRA_IMAGE_FEATURES', 'dbg-pkgs')

    if (d.getVar('NOPTMZ', True) == '1'):
        d.setVar('DEBUG_BUILD', '1')
        d.setVar('DEBUG_FLAGS', '-feliminate-unused-debug-types')
}
```

## poky/meta-qti-bsp/conf/machine/include/arm/arch-armv8a.inc
```bitbake
DEFAULTTUNE ?= "armv8a"

TUNEVALID[armv8a] = "Enable instructions for ARMv8-a"
TUNEVALID[crc] = "Enable CRC instrucitons for ARMv8-a"
TUNECONFLICTS[armv8a] = "armv4 armv5 armv6 armv7 armv7a"
TUNE_CCARGS .= "${@bb.utils.contains("TUNE_FEATURES", "armv8a", " -march=armv8-a", "", d)}"
TUNE_CCARGS .= "${@bb.utils.contains("TUNE_FEATURES", "crc", "+crc", "", d)}"
MACHINEOVERRIDES =. "${@bb.utils.contains("TUNE_FEATURES", "armv8a", "armv8a:", "" ,d)}"

require conf/machine/include/arm/arch-armv7a.inc

# Little Endian base configs
AVAILTUNES += "armv8a armv8a-vfpv3 armv8a-neon armv8a-vfpv4 armv8a-neon-vfpv4 armv8a-fp-armv8 armv8a-neon-fp-armv8 armv8a-crypto-neon-fp-armv8"
ARMPKGARCH_tune-armv8a ?= "armv8a"
ARMPKGARCH_tune-armv8a-vfpv3 ?= "armv8a"
ARMPKGARCH_tune-armv8a-neon ?= "armv8a"
ARMPKGARCH_tune-armv8a-vfpv4 ?= "armv8a"
ARMPKGARCH_tune-armv8a-neon-vfpv4 ?= "armv8a"
ARMPKGARCH_tune-armv8a-fp-armv8 ?= "armv8a"
ARMPKGARCH_tune-armv8a-neon-fp-armv8 ?= "armv8a"
ARMPKGARCH_tune-armv8a-crypto-neon-fp-armv8 ?= "armv8a"
TUNE_FEATURES_tune-armv8a ?= "arm armv8a vfp"
TUNE_FEATURES_tune-armv8a-vfpv3 ?= "${TUNE_FEATURES_tune-armv8a} vfpv3"
TUNE_FEATURES_tune-armv8a-neon ?= "${TUNE_FEATURES_tune-armv8a} neon"
TUNE_FEATURES_tune-armv8a-vfpv4 ?= "${TUNE_FEATURES_tune-armv8a} vfpv4"
TUNE_FEATURES_tune-armv8a-neon-vfpv4 ?= "${TUNE_FEATURES_tune-armv8a} neon vfpv4"
TUNE_FEATURES_tune-armv8a-fp-armv8 ?= "${TUNE_FEATURES_tune-armv8a} fp-armv8"
TUNE_FEATURES_tune-armv8a-neon-fp-armv8 ?= "${TUNE_FEATURES_tune-armv8a} neon fp-armv8"
TUNE_FEATURES_tune-armv8a-crypto-neon-fp-armv8 ?= "${TUNE_FEATURES_tune-armv8a} crypto neon fp-armv8"
PACKAGE_EXTRA_ARCHS_tune-armv8a = "${PACKAGE_EXTRA_ARCHS_tune-armv7a} armv8a armv8a-vfp"
PACKAGE_EXTRA_ARCHS_tune-armv8a-vfpv3 = "${PACKAGE_EXTRA_ARCHS_tune-armv8a} armv8a-vfp-vfpv3"
PACKAGE_EXTRA_ARCHS_tune-armv8a-neon = "${PACKAGE_EXTRA_ARCHS_tune-armv8a-vfpv3} armv8a-vfp-neon"
PACKAGE_EXTRA_ARCHS_tune-armv8a-vfpv4 = "${PACKAGE_EXTRA_ARCHS_tune-armv8a-vfpv3} armv8a-vfp-vfpv4"
PACKAGE_EXTRA_ARCHS_tune-armv8a-neon-vfpv4 = "${PACKAGE_EXTRA_ARCHS_tune-armv8a-vfpv4} armv8a-vfp-neon armv8a-vfp-neon-vfpv4"
PACKAGE_EXTRA_ARCHS_tune-armv8a-fp-armv8 = "${PACKAGE_EXTRA_ARCHS_tune-armv8a} armv8a-vfp-fp-armv8"
PACKAGE_EXTRA_ARCHS_tune-armv8a-neon-fp-armv8 = "${PACKAGE_EXTRA_ARCHS_tune-armv8a-fp-armv8} armv8a-vfp-neon-fp-armv8"
PACKAGE_EXTRA_ARCHS_tune-armv8a-crypto-neon-fp-armv8 = "${PACKAGE_EXTRA_ARCHS_tune-armv8a-neon-fp-armv8} armv8a-vfp-crypto-neon-fp-armv8"

# CRC configs
AVAILTUNES += "armv8a-crc armv8a-crc-vfpv3 armv8a-crc-neon armv8a-crc-vfpv4 armv8a-crc-neon-vfpv4 armv8a-crc-fp-armv8 armv8a-crc-neon-fp-armv8 armv8a-crc-crypto-neon-fp-armv8"
ARMPKGARCH_tune-armv8a-crc ?= "armv8a"
ARMPKGARCH_tune-armv8a-crc-vfpv3 ?= "armv8a"
ARMPKGARCH_tune-armv8a-crc-neon ?= "armv8a"
ARMPKGARCH_tune-armv8a-crc-vfpv4 ?= "armv8a"
ARMPKGARCH_tune-armv8a-crc-neon-vfpv4 ?= "armv8a"
ARMPKGARCH_tune-armv8a-crc-fp-armv8 ?= "armv8a"
ARMPKGARCH_tune-armv8a-crc-neon-fp-armv8 ?= "armv8a"
ARMPKGARCH_tune-armv8a-crc-crypto-neon-fp-armv8 ?= "armv8a"
TUNE_FEATURES_tune-armv8a-crc ?= "${TUNE_FEATURES_tune-armv8a} crc"
TUNE_FEATURES_tune-armv8a-crc-vfpv3 ?= "${TUNE_FEATURES_tune-armv8a-vfpv3} crc"
TUNE_FEATURES_tune-armv8a-crc-neon ?= "${TUNE_FEATURES_tune-armv8a-neon} crc"
TUNE_FEATURES_tune-armv8a-crc-vfpv4 ?= "${TUNE_FEATURES_tune-armv8a-vfpv4} crc"
TUNE_FEATURES_tune-armv8a-crc-neon-vfpv4 ?= "${TUNE_FEATURES_tune-armv8a-neon-vfpv4} crc"
TUNE_FEATURES_tune-armv8a-crc-fp-armv8 ?= "${TUNE_FEATURES_tune-armv8a-fp-armv8} crc"
TUNE_FEATURES_tune-armv8a-crc-neon-fp-armv8 ?= "${TUNE_FEATURES_tune-armv8a-neon-fp-armv8} crc"
TUNE_FEATURES_tune-armv8a-crc-crypto-neon-fp-armv8 ?= "${TUNE_FEATURES_tune-armv8a-crypto-neon-fp-armv8} crc"
PACKAGE_EXTRA_ARCHS_tune-armv8a-crc = "${PACKAGE_EXTRA_ARCHS_tune-armv8a} armv8a-crc-vfp"
PACKAGE_EXTRA_ARCHS_tune-armv8a-crc-vfpv3 = "${PACKAGE_EXTRA_ARCHS_tune-armv8a-crc} armv8a-vfp-vfpv3 armv8a-crc-vfp-vfpv3"
PACKAGE_EXTRA_ARCHS_tune-armv8a-crc-neon = "${PACKAGE_EXTRA_ARCHS_tune-armv8a-crc-vfpv3} armv8a-vfp-neon armv8a-crc-vfp-neon"
PACKAGE_EXTRA_ARCHS_tune-armv8a-crc-vfpv4 = "${PACKAGE_EXTRA_ARCHS_tune-armv8a-crc-vfpv3} armv8a-vfp-vfpv4 armv8a-crc-vfp-vfpv4"
PACKAGE_EXTRA_ARCHS_tune-armv8a-crc-neon-vfpv4 = "${PACKAGE_EXTRA_ARCHS_tune-armv8a-crc-vfpv4} armv8a-vfp-neon armv8a-crc-vfp-neon armv8a-vfp-neon-vfpv4 armv8a-crc-vfp-neon-vfpv4"
PACKAGE_EXTRA_ARCHS_tune-armv8a-crc-fp-armv8 = "${PACKAGE_EXTRA_ARCHS_tune-armv8a-crc} armv8a-vfp-fp-armv8 armv8a-vfp-fp-crc-armv8"
PACKAGE_EXTRA_ARCHS_tune-armv8a-crc-neon-fp-armv8 = "${PACKAGE_EXTRA_ARCHS_tune-armv8a-crc-fp-armv8} armv8a-vfp-neon-fp-armv8 armv8a-crc-vfp-neon-fp-armv8"
PACKAGE_EXTRA_ARCHS_tune-armv8a-crc-crypto-neon-fp-armv8 = "${PACKAGE_EXTRA_ARCHS_tune-armv8a-crc-neon-fp-armv8} armv8a-vfp-crypto-neon-fp-armv8 armv8a-crc-vfp-crypto-neon-fp-armv8"
```
