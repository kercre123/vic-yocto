## poky/old-meta-qti-core/conf/layer.conf
```bitbake
BBFILES += "${LAYERDIR}/recipes/*/*.bb ${LAYERDIR}/recipes/*/*.bbappend ${LAYERDIR}/recipes-*/*/*.bb ${LAYERDIR}/recipes-products/images/*.bbappend"
BBPATH .= ":${LAYERDIR}"
BBFILE_COLLECTIONS += "msm-core"
BBFILE_PRIORITY_msm-core = "12"
BBFILE_PATTERN_msm-core := "^${LAYERDIR}/"
```

## poky/old-meta-qti-data/conf/layer.conf
```bitbake
BBFILES += "${LAYERDIR}/recipes/*/*.bb ${LAYERDIR}/recipes/*/*.bbappend ${LAYERDIR}/recipes-*/*/*.bb ${LAYERDIR}/recipes-products/images/*.bbappend"
BBPATH .= ":${LAYERDIR}"
BBFILE_COLLECTIONS += "msm-data"
BBFILE_PRIORITY_msm-data = "12"
BBFILE_PATTERN_msm-data := "^${LAYERDIR}/"
```

## poky/old-meta-qti-qmmf/conf/layer.conf
```bitbake
BBFILES += "${LAYERDIR}/recipes/*/*.bb ${LAYERDIR}/recipes/*/*.bbappend ${LAYERDIR}/recipes-*/*/*.bb ${LAYERDIR}/recipes-*/*/*.bbappend"
BBPATH .= ":${LAYERDIR}"
BBFILE_COLLECTIONS += "qmmf"
BBFILE_PRIORITY_qmmf = "12"
BBFILE_PATTERN_qmmf := "^${LAYERDIR}/"
```

## poky/old-meta-qti-wlan/conf/layer.conf
```bitbake
BBFILES += "${LAYERDIR}/recipes/*/*.bb ${LAYERDIR}/recipes/*/*.bbappend ${LAYERDIR}/recipes-*/*/*.bb ${LAYERDIR}/recipes-products/images/*.bbappend"
BBPATH .= ":${LAYERDIR}"
BBFILE_COLLECTIONS += "wlan"
BBFILE_PRIORITY_wlan = "12"
BBFILE_PATTERN_wlan := "^${LAYERDIR}/"
```

## poky/old-meta-selinux/conf/distro/oe-selinux.conf
```bitbake
DISTRO = "oe-selinux"
DISTROOVERRIDES .= ":selinux"

DISTRO_FEATURES_append = " acl xattr pam selinux"
```

## poky/old-meta-selinux/conf/distro/poky-selinux.conf
```bitbake
require conf/distro/poky.conf
require conf/distro/oe-selinux.conf

DISTRO = "poky-selinux"
```

## poky/old-meta-selinux/conf/layer.conf
```bitbake
# We have a conf and classes directory, add to BBPATH
BBPATH .= ":${LAYERDIR}"

# We have a packages directory, add to BBFILES
BBFILES += "${LAYERDIR}/recipes-*/*/*.bb \
            ${LAYERDIR}/recipes-*/*/*.bbappend"

# Let us add layer-specific bbappends which are only applied when that
# layer is included in our configuration
BBFILES += "${@' '.join('${LAYERDIR}/%s/recipes*/*/*.bbappend' % layer \
               for layer in BBFILE_COLLECTIONS.split())}"

BBFILE_COLLECTIONS += "selinux"
BBFILE_PATTERN_selinux = "^${LAYERDIR}/"
BBFILE_PRIORITY_selinux = "5"

# This should only be incremented on significant changes that will
# cause compatibility issues with other layers
LAYERVERSION_selinux = "1"

LAYERDEPENDS_selinux = " \
    core \
"
```

## qcom-opensource/ethernet/neutrino-pcie/driver/Kconfig
```kconfig
config NEUTRINO_ETH
	bool "Neutrino Ethernet driver support"
	depends on PCI
	select PHYLIB
	select PTP_1588_CLOCK
	select CONFIG_IPA
	default y
	---help---
	  Say y here if you want to use the built-in Neutrino ethernet
```
