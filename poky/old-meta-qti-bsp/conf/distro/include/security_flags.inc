## poky/old-meta-qti-bsp/conf/distro/include/security_flags.inc
```bitbake
# Pull in the default security flags
require ${COREBASE}/meta/conf/distro/include/security_flags.inc

# Modify the primary security flag definitions
SECURITY_CFLAGS = "-fstack-protector-strong ${lcl_maybe_fortify}"
SECURITY_LDFLAGS = "-Wl,-z,relro,-z,now,-z,noexecstack"

SECURITY_PIE_CFLAGS = "-fstack-protector-strong -pie -fPIE -Wa,--noexecstack ${lcl_maybe_fortify}"
SECURITY_PIC_CFLAGS = "-fstack-protector-strong -fstack-protector-strong -fPIC -Wa,--noexecstack ${lcl_maybe_fortify}"

SECURITY_PIE_NO_FORTIFY_CFLAGS = "-fstack-protector-strong -pie -fPIE -Wa,--noexecstack"

# GPS OSS packages to use -fPIC in security flags instead of -fpie
SECURITY_CFLAGS_pn-loc-hal = "${SECURITY_PIC_CFLAGS}"
SECURITY_CFLAGS_pn-loc-pla = "${SECURITY_PIC_CFLAGS}"
SECURITY_CFLAGS_pn-loc-stub = "${SECURITY_PIC_CFLAGS}"
SECURITY_CFLAGS_pn-gps-utils = "${SECURITY_PIC_CFLAGS}"
SECURITY_CFLAGS_pn-loc-net-iface = "${SECURITY_PIC_CFLAGS}"

SECURITY_CFLAGS_pn-system-media = "${SECURITY_PIE_NO_FORTIFY_CFLAGS}"
SECURITY_CFLAGS_pn-audiohal = "${SECURITY_PIE_NO_FORTIFY_CFLAGS}"

SECURITY_CFLAGS_pn-connman = "${SECURITY_PIE_CFLAGS}"
SECURITY_CFLAGS_pn-chrony = "${SECURITY_PIE_CFLAGS}"
SECURITY_CFLAGS_pn-system-core = "${SECURITY_PIE_CFLAGS}"
```

## poky/old-meta-qti-bsp/conf/distro/mdm-perf.conf
```bitbake
###############################################################################################
#@TYPE: Distribution
#@NAME: MDM-PERF
#@DESCRIPTION: QTI Linux Distribution for MDM targets with performance orientation (glibc based)
################################################################################################

require conf/distro/include/msm.inc

# DISTRO CONFIGURATION
DISTRO_NAME = "mdm-perf"
DISTRO_VERSION = "${BUILDNAME}"
VIRTUAL-RUNTIME_dev_manager ?= "busybox-mdev"

# Add mdm-perf to distro overrides
DISTROOVERRIDES = "mdm:mdm-perf"

# Basic distribution features
DISTRO_FEATURES += "sysvinit eabi ipv6 ipv4 largefile thumb-interwork xattr ${MICRO_GOLD} ${DISTRO_FEATURES_LIBC}"

# MDMs are NAND based targets
DISTRO_FEATURES += "nand-boot"

# Enable performance features
PERF_BUILD = "1"

# Retain existing directory structure for base product image.
# Append variants like '-perf', '-user', 'perf-minimal' etc to deploy dir.
DEPLOY_NAME ?= "${MACHINE}${@['-' + d.getVar('PRODUCT', True), ''][d.getVar('PRODUCT', True) == ('' or 'base')]}${@['-' + d.getVar('VARIANT', True), ''][d.getVar('VARIANT', True) == ('')]}"
DEPLOY_DIR_IMAGE = "${DEPLOY_DIR}/images/${DEPLOY_NAME}"
```

## poky/old-meta-qti-bsp/conf/distro/mdm.conf
```bitbake
#############################################################################
#@TYPE: Distribution
#@NAME: MDM
#@DESCRIPTION: QTI Linux Distribution for MDM targets (glibc based)
#############################################################################

require conf/distro/include/msm.inc

# DISTRO CONFIGURATION
DISTRO_NAME = "mdm"
DISTRO_VERSION = "${BUILDNAME}"
VIRTUAL-RUNTIME_dev_manager ?= "busybox-mdev"

# Add distro overrides
DISTROOVERRIDES = "mdm"

# Basic distribution features
DISTRO_FEATURES += "sysvinit eabi ipv6 ipv4 largefile thumb-interwork xattr ${MICRO_GOLD} ${DISTRO_FEATURES_LIBC}"

# MDMs are nand based targets
DISTRO_FEATURES += "nand-boot"

#Enable for Read only system
DISTRO_FEATURES += "ro-rootfs"

# Retain existing directory structure for base product image.
# Append variants like '-perf', '-user', 'perf-minimal' etc to deploy dir.
DEPLOY_NAME ?= "${MACHINE}${@['-' + d.getVar('PRODUCT', True), ''][d.getVar('PRODUCT', True) == ('' or 'base')]}${@['-' + d.getVar('VARIANT', True), ''][d.getVar('VARIANT', True) == ('')]}"
DEPLOY_DIR_IMAGE = "${DEPLOY_DIR}/images/${DEPLOY_NAME}"
```

## poky/old-meta-qti-bsp/conf/distro/msm.conf
```bitbake
#############################################################################
#@TYPE: Distribution
#@NAME: MSM
#@DESCRIPTION: MSM Linux Distribution (glibc based)
#############################################################################

require conf/distro/include/msm.inc

# DISTRO CONFIGURATION
DISTRO_NAME = "msm"
DISTRO_VERSION = "${BUILDNAME}"
LINUX_KERNEL_TYPE = "debug"
VIRTUAL-RUNTIME_dev_manager ?= "busybox-mdev"

# Add distro overrides
DISTROOVERRIDES = "msm"

# Basic distribution features
DISTRO_FEATURES += "sysvinit eabi ipv6 ipv4 largefile thumb-interwork xattr ${MICRO_GOLD} ${DISTRO_FEATURES_LIBC}"

# MSMs are emmc based targets
DISTRO_FEATURES += "emmc-boot"

# Retain existing directory structure for base product image.
# Append variants like '-perf', '-user', 'perf-minimal' etc to deploy dir.
DEPLOY_NAME ?= "${MACHINE}${@['-' + d.getVar('PRODUCT', True), ''][d.getVar('PRODUCT', True) == ('' or 'base')]}${@['-' + d.getVar('VARIANT', True), ''][d.getVar('VARIANT', True) == ('')]}"
DEPLOY_DIR_IMAGE = "${DEPLOY_DIR}/images/${DEPLOY_NAME}"
```

## poky/old-meta-qti-bsp/conf/layer.conf
```bitbake
BBFILES += "${LAYERDIR}/recipes/*/*.bb ${LAYERDIR}/recipes/*/*.bbappend ${LAYERDIR}/recipes-*/*/*.bb ${LAYERDIR}/recipes-*/*/*.bbappend"
BBPATH .= ":${LAYERDIR}"
BBFILE_COLLECTIONS += "msm"
BBFILE_PRIORITY_msm = "10"
BBFILE_PATTERN_msm := "^${LAYERDIR}/"
LICENSE_PATH += "${LAYERDIR}/files/anki-licenses"
```

## poky/old-meta-qti-bsp/conf/machine/apq8009-qsap.conf
```bitbake
#@TYPE: Machine
#@NAME: APQ8009 MTP
#@DESCRIPTION: Machine configuration for QTI MTP with APQ8009

require conf/machine/include/apq8009.inc

PREFERRED_PROVIDER_virtual/kernel ?= "linux-quic"

KERNEL_IMAGETYPE = "zImage-dtb"
KERNEL_DTS_NAME = "msm8909"
KERNEL_BASE = "0x81C00000"
KERNEL_TAGS_OFFSET = "0x81900000"
KERNEL_DEFCONFIG = "msm8909_defconfig"
KERNEL_PERF_DEFCONFIG = "msm8909-perf_defconfig"
KERNEL_CMD_PARAMS = "noinitrd rw console=ttyHSL0,115200,n8 androidboot.hardware=qcom ehci-hcd.park=3 msm_rtb.filter=0x37 lpm_levels.sleep_disabled=1 rootwait androidboot.bootdevice=7824900.sdhci"

DISTRO_FEATURES_append=" selinux"
PREFERRED_VERSION_refpolicy-standard="2.20141203"
DEFAULT_ENFORCING = "enforcing"
```

## poky/old-meta-qti-bsp/conf/machine/apq8009-robot.conf
```bitbake
#@TYPE: Machine
#@NAME: APQ8009 MTP
#@DESCRIPTION: Machine configuration for QTI MTP with APQ8009

require conf/machine/include/apq8009.inc

PREFERRED_PROVIDER_virtual/kernel ?= "linux-quic"

KERNEL_IMAGETYPE = "zImage-dtb"

KERNEL_DTS_NAME = "msm8909"
KERNEL_BASE = "0x81C00000"
KERNEL_TAGS_OFFSET = "0x81900000"

# setting mem=511M as the last MB is reserved for panic reporting
KERNEL_CMD_PARAMS = "noinitrd ro console=ttyHSL0,115200,n8 androidboot.hardware=qcom ehci-hcd.park=3 msm_rtb.filter=0x37 lpm_levels.sleep_disabled=1 rootwait androidboot.bootdevice=7824900.sdhci mem=511M"

# Use systemd init manager.
DISTRO_FEATURES_append = " systemd"
DISTRO_FEATURES_append += "ro-rootfs"
DISTRO_FEATURES_BACKFILL_CONSIDERED += "sysvinit"
VIRTUAL-RUNTIME_dev_manager = "udev"
VIRTUAL-RUNTIME_init_manager = "systemd"
DISTRO_FEATURES_remove = "sysvinit"

# Use avahi-daemon
DISTRO_FEATURES_append += "avahi"

#Enable the factory reset of data partition
DISTRO_FEATURES_append = " userfs-factory-reset "

# Disable journalling for RO rootfs. Set the block size to 1024.
# BRC: Leave journalling ENABLED for DEVELOPER builds
# IMAGE_EXT4_EXTRA_OPTIONS = "${@base_contains('DISTRO_FEATURES','ro-rootfs',' -J -b 1024 ','',d)}"

# Change Image features for systemd.
IMAGE_DEV_MANAGER = "udev"
IMAGE_INIT_MANAGER = "systemd"
IMAGE_INITSCRIPTS = ""
LICENSE_FLAGS_WHITELIST = "commercial_gstreamer1.0-omx commercial_libomxil commercial_gstreamer1.0-libav"

#UBINIZE Args
UBINIZE_ARGS ?= "-m 2048 -p 128KiB"
#MKUBIFS Args
MKUBIFS_ARGS ?= "-m 2048 -e 126976 -c 4096 -F -v"
#Volume sizes
#PERSIST UBI Args
MKUBIFS_PERSIST_ARGS ?= "-m 2048 -e 126976 -c 4096 -j 2MiB -F -v"

SYSTEM_VOLUME_SIZE ?= "600MiB"
CACHE_VOLUME_SIZE ?= "37MiB"
PERSIST_VOLUME_SIZE ?= "4MiB"
PAGE_SIZE = '2048'

# Enable conventional Yocto Wi-Fi tools
DISTRO_FEATURES_append += "wifi"

INITRAMFS_IMAGE = "core-image-anki-initramfs"
INITRAMFS_IMAGE_BUNDLE = "0"
```

## poky/old-meta-qti-bsp/conf/machine/apq8009.conf
```bitbake
#@TYPE: Machine
#@NAME: APQ8009 MTP
#@DESCRIPTION: Machine configuration for QTI MTP with APQ8009

require conf/machine/include/apq8009.inc

PREFERRED_PROVIDER_virtual/kernel ?= "linux-quic"

KERNEL_IMAGETYPE = "zImage-dtb"

KERNEL_DTS_NAME = "msm8909"
KERNEL_BASE = "0x81C00000"
KERNEL_TAGS_OFFSET = "0x81900000"
KERNEL_DEFCONFIG = "msm8909_defconfig"
KERNEL_PERF_DEFCONFIG = "msm8909-perf_defconfig"
KERNEL_CMD_PARAMS = "noinitrd ro console=ttyHSL0,115200,n8 androidboot.hardware=qcom ehci-hcd.park=3 msm_rtb.filter=0x37 lpm_levels.sleep_disabled=1 rootwait androidboot.bootdevice=7824900.sdhci mem=512M isolcpus=3"

# Use systemd init manager.
DISTRO_FEATURES_append = " systemd"
DISTRO_FEATURES_append += "ro-rootfs"
DISTRO_FEATURES_BACKFILL_CONSIDERED += "sysvinit"
VIRTUAL-RUNTIME_dev_manager = "udev"
VIRTUAL-RUNTIME_init_manager = "systemd"
DISTRO_FEATURES_remove = "sysvinit"

# Change Image features for systemd.
IMAGE_DEV_MANAGER = "udev"
IMAGE_INIT_MANAGER = "systemd"
IMAGE_INITSCRIPTS = ""
LICENSE_FLAGS_WHITELIST = "commercial_gstreamer1.0-omx commercial_libomxil commercial_gstreamer1.0-libav commercial_lame commercial_libmad commercial_mpeg2dec"

DISTRO_FEATURES_append += "selinux"
PREFERRED_VERSION_refpolicy-standard="2.20141203"
DEFAULT_ENFORCING = "permissive"
```

## poky/old-meta-qti-bsp/conf/machine/apq8017.conf
```bitbake
#@TYPE: Machine
#@NAME: APQ8017
#@DESCRIPTION: Machine configuration for QTI MTP with APQ8017

require conf/machine/include/apq8017.inc

PREFERRED_PROVIDER_virtual/kernel ?= "linux-quic"

KERNEL_IMAGETYPE = "Image.gz-dtb"
KERNEL_DTS_NAME = "msm8917"
KERNEL_BASE = "0x81C00000"
KERNEL_TAGS_OFFSET = "0x81900000"
KERNEL_DEFCONFIG = "msm8937_defconfig"
KERNEL_PERF_DEFCONFIG = "msm8937-perf_defconfig"
KERNEL_CMD_PARAMS = "noinitrd ro console=ttyHSL0,115200,n8 androidboot.hardware=qcom ehci-hcd.park=3 msm_rtb.filter=0x37 lpm_levels.sleep_disabled=1 rootwait androidboot.bootdevice=7824900.sdhci"
DISTRO_FEATURES_append = " ro-rootfs"
KERNEL_PERF_CMD_PARAMS = "noinitrd ro androidboot.hardware=qcom ehci-hcd.park=3 msm_rtb.filter=0x37 lpm_levels.sleep_disabled=1 root=/dev/mmcblk0p24 rootfstype=ext4 rootwait androidboot.bootdevice=7824900.sdhci fstab=no"
DISTRO_FEATURES_remove = "sysvinit"

# Use systemd init manager.
DISTRO_FEATURES_append = " systemd"
DISTRO_FEATURES_BACKFILL_CONSIDERED += "sysvinit"
VIRTUAL-RUNTIME_dev_manager = "udev"
VIRTUAL-RUNTIME_init_manager = "systemd"

# Change Image features for systemd.
IMAGE_DEV_MANAGER = "udev"
IMAGE_INIT_MANAGER = "systemd"
IMAGE_INITSCRIPTS = ""

DISTRO_FEATURES_append = " userfs-factory-reset "
#these are for adding the sellinux
DISTRO_FEATURES_append=" selinux"
# Freeze refpolicy at the latest version supported by meta-selinux
PREFERRED_VERSION_refpolicy-standard="2.20141203"
DEFAULT_ENFORCING = "enforcing"
```

## poky/old-meta-qti-bsp/conf/machine/apq8053-32.conf
```bitbake
#@TYPE: Machine
#@NAME: APQ8053-32
#@DESCRIPTION: 32-bit Machine configuration for QTI MTP with APQ8053

require conf/machine/include/apq8053.inc

DEFAULTTUNE = "armv7a-neon"

PREFERRED_PROVIDER_virtual/kernel = "linux-quic"

KERNEL_IMAGETYPE = "zImage-dtb"
KERNEL_DTS_NAME = "msm8953"
KERNEL_BASE = "0x80000000"
KERNEL_TAGS_OFFSET = "0x81900000"
KERNEL_DEFCONFIG = "msmcortex_defconfig"
KERNEL_CMD_PARAMS = "noinitrd ro console=ttyHSL0,115200,n8 androidboot.hardware=qcom ehci-hcd.park=3 msm_rtb.filter=0x37 lpm_levels.sleep_disabled=1 rootwait androidboot.bootdevice=7824900.sdhci"

# Perf kernel configs
KERNEL_PERF_IMAGETYPE = "zImage-dtb"
KERNEL_PERF_DEFCONFIG = "apq8053_IoE-perf_defconfig"
KERNEL_PERF_CMD_PARAMS = "noinitrd ro androidboot.hardware=qcom ehci-hcd.park=3 msm_rtb.filter=0x37 lpm_levels.sleep_disabled=1 rootwait androidboot.bootdevice=7824900.sdhci"

# readonly-rootfs
DISTRO_FEATURES_append = " ro-rootfs"

# face recognition
DISTRO_FEATURES_append = " face-recognition"

# Disable journalling for RO rootfs. Set the block size to 1024.
IMAGE_EXT4_EXTRA_OPTIONS = "${@base_contains('DISTRO_FEATURES','ro-rootfs',' -J -b 1024 ','',d)}"
```

## poky/old-meta-qti-bsp/conf/machine/apq8053.conf
```bitbake
#@TYPE: Machine
#@NAME: APQ8053
#@DESCRIPTION: Machine configuration for QTI MTP with APQ8053

require conf/machine/include/apq8053.inc

PREFERRED_PROVIDER_virtual/kernel ?= "linux-quic"

KERNEL_IMAGETYPE = "Image.gz-dtb"
KERNEL_DTS_NAME = "msm8953"
KERNEL_BASE = "0x80000000"
KERNEL_TAGS_OFFSET = "0x81900000"
KERNEL_DEFCONFIG = "msmcortex_defconfig"
KERNEL_CMD_PARAMS = "noinitrd ro console=ttyHSL0,115200,n8 androidboot.hardware=qcom ehci-hcd.park=3 msm_rtb.filter=0x37 lpm_levels.sleep_disabled=1 rootwait androidboot.bootdevice=7824900.sdhci"

# Perf kernel configs
KERNEL_PERF_IMAGETYPE = "Image-dtb"
KERNEL_PERF_DEFCONFIG = "apq8053_IoE-perf_defconfig"
KERNEL_PERF_CMD_PARAMS = "noinitrd ro androidboot.hardware=qcom ehci-hcd.park=3 msm_rtb.filter=0x37 lpm_levels.sleep_disabled=1 rootwait androidboot.bootdevice=7824900.sdhci"

BBMASK .= "|.*/*/recipes-security/libselinux/"

# selinux
DISTRO_FEATURES_append = " selinux"
# Freeze refpolicy at the latest version supported by meta-selinux
PREFERRED_VERSION_refpolicy-standard="2.20141203"
DEFAULT_ENFORCING = "enforcing"

# readonly-rootfs
DISTRO_FEATURES_append = " ro-rootfs"

# Disable journalling for RO rootfs. Set the block size to 1024.
IMAGE_EXT4_EXTRA_OPTIONS = "${@base_contains('DISTRO_FEATURES','ro-rootfs',' -J -b 1024 ','',d)}"

# location packages
DISTRO_FEATURES_append = " location-services"

# face recognition
DISTRO_FEATURES_append = " face-recognition"
DISTRO_FEATURES_append = " le-clang"
# iproute2 bump version to 4.1.1
PREFERRED_VERSION_iproute2 = "4.1.1"

# Add all QTI audio extension to the machine.
DISTRO_FEATURES_append = " qti-audio-extensions"

# Multilib configuration
# This sets any packages preprended with lib32- to be built with
# the armv7a tuning (32 bit) instead of 64 bit aarch.
require conf/multilib.conf
MULTILIBS = "multilib:lib32"
DEFAULTTUNE_virtclass-multilib-lib32 = "armv7a-neon"
```

## poky/old-meta-qti-bsp/conf/machine/apq8096-excelsior.conf
```bitbake
#@TYPE: Machine
#@NAME: APQ8096-EXCELSIOR
#@DESCRIPTION: Machine configuration for QTI with APQ8096 EXCELSIOR

require conf/machine/include/apq8096.inc

PREFERRED_PROVIDER_virtual/kernel ?= "linux-quic"

KERNEL_IMAGETYPE = "Image.gz-dtb"
KERNEL_DTS_NAME = "msm8996"
KERNEL_BASE = "0x80000000"
KERNEL_TAGS_OFFSET = "0x81900000"
KERNEL_DEFCONFIG = "msm_defconfig"
KERNEL_PERF_DEFCONFIG = "msm-perf_defconfig"
KERNEL_CMD_PARAMS = "noinitrd rw console=ttyHSL0,115200,n8 androidboot.hardware=qcom ehci-hcd.park=3 msm_rtb.filter=0x37 lpm_levels.sleep_disabled=1 rootwait"

DISTRO_FEATURES_append=" pam"

#these are for adding the sellinux
DISTRO_FEATURES_append=" selinux"
# Freeze refpolicy at the latest version supported by meta-selinux
PREFERRED_VERSION_refpolicy-standard="2.20141203"
DEFAULT_ENFORCING = "enforcing"

# face recognition
DISTRO_FEATURES_append = " face-recognition"
```
