## poky/old-meta-qti-bsp/conf/machine/apq8096.conf
```bitbake
#@TYPE: Machine
#@NAME: APQ8096
#@DESCRIPTION: Machine configuration for QTI MTP with APQ8096

require conf/machine/include/apq8096.inc

PREFERRED_PROVIDER_virtual/kernel ?= "linux-quic"

KERNEL_IMAGETYPE = "Image.gz-dtb"
KERNEL_DTS_NAME = "msm8996"
KERNEL_BASE = "0x80000000"
KERNEL_TAGS_OFFSET = "0x81900000"
KERNEL_DEFCONFIG = "msm_defconfig"
KERNEL_PERF_DEFCONFIG = "msm-perf_defconfig"
KERNEL_CMD_PARAMS = "noinitrd rw console=ttyHSL0,115200,n8 androidboot.hardware=qcom ehci-hcd.park=3 msm_rtb.filter=0x37 lpm_levels.sleep_disabled=0 rootwait net.ifnames=0"

DISTRO_FEATURES_append=" pam"

#These are for enabling the selinux layer
DISTRO_FEATURES_append=" selinux"
# Freeze refpolicy at the latest version supported by meta-selinux
PREFERRED_VERSION_refpolicy-standard="2.20141203"
DEFAULT_ENFORCING = "enforcing"

# face recognition
DISTRO_FEATURES_append = " face-recognition"

DISTRO_FEATURES_remove = "sysvinit"

# Use systemd init manager.
DISTRO_FEATURES_append = " systemd"
DISTRO_FEATURES_BACKFILL_CONSIDERED += "sysvinit"
VIRTUAL-RUNTIME_dev_manager = "udev"
VIRTUAL-RUNTIME_init_manager = "systemd"

# Change Image features for systemd.
IMAGE_DEV_MANAGER = "udev"
IMAGE_INIT_MANAGER = "systemd"
IMAGE_INITSCRIPTS = ""
```

## poky/old-meta-qti-bsp/conf/machine/apq8098.conf
```bitbake
#@TYPE: Machine
#@NAME: APQ8098
#@DESCRIPTION: Machine configuration for QTI MTP with APQ8098

require conf/machine/include/apq8098.inc

PREFERRED_PROVIDER_virtual/kernel ?= "linux-msm-4.4"

KERNEL_IMAGETYPE = "Image.gz-dtb"
KERNEL_DTS_NAME = "msmcobalt"
KERNEL_BASE = "0x80000000"
KERNEL_TAGS_OFFSET = "0x81900000"
KERNEL_DEFCONFIG = "msmcortex_mediabox_defconfig"
KERNEL_PERF_DEFCONFIG = "msmcortex_mediabox-perf_defconfig"
KERNEL_CMD_PARAMS = "noinitrd rw rootwait console=ttyMSM0,115200,n8 no_console_suspend=1 earlycon=msm_serial_dm,0xc1b0000 androidboot.hardware=qcom androidboot.console=ttyMSM0 service_locator.enable=1 sched_enable_hmp=1 sched_enable_power_aware=1 ehci-hcd.park=3 msm_rtb.filter=0x37 lpm_levels.sleep_disabled=1 root=/dev/sde20 rootfstype=ext4 earlyprintk"
DISTRO_FEATURES_append=" selinux"
# Freeze refpolicy at the latest version supported by meta-selinux
PREFERRED_VERSION_refpolicy-standard="2.20141203"
DEFAULT_ENFORCING = "enforcing"
LICENSE_FLAGS_WHITELIST = "commercial_gstreamer1.0-omx commercial_libomxil commercial_gstreamer1.0-libav commercial_lame commercial_libmad commercial_mpeg2dec"
```

## poky/old-meta-qti-bsp/conf/machine/include/apq8009.inc
```bitbake
BASEMACHINE ?= "apq8009"
require conf/machine/include/basemachine.inc

SOC_FAMILY ?= "msm8909"
include conf/machine/include/soc-family.inc

# Uncomment the following line to enable the hard floating point abi. Note that
# this breaks some binary libraries and 3D (neither of which ship with
# meta-yocto). For maximum compatibility, leave this disabled.
#DEFAULTTUNE ?= "cortexa8hf-neon"

include conf/machine/include/tune-cortexa7.inc

BBMASK = ".*/*/recipes-kernel/linux-msm-4.4"

MACHINE_DISPLAY_WIDTH_PIXELS ?= "480"
MACHINE_DISPLAY_HEIGHT_PIXELS ?= "640"

SERIAL_CONSOLE ?= "115200 ttyHSL0"

DISTRO ?="msm"

MACHINE_FEATURES += "kernel26 keyboard"

PAGE_SIZE ?= '4096'

# Max supported inodes
EXTRA_IMAGECMD ?= "-N 2048"

# Sizes for EXT4 (in bytes)
SYSTEM_SIZE_EXT4 ?= "603979776"
SYSTEMRW_SIZE_EXT4 ?= "8388608"
USERDATA_SIZE_EXT4 ?= "805306368"
CACHE_SIZE_EXT4 ?= "939524096"

# Enable LE Verified Boot
DISTRO_FEATURES_append = " vble"

# Formats of root filesystem images.
IMAGE_FSTYPES += "ext4"
```

## poky/old-meta-qti-bsp/conf/machine/include/apq8098.inc
```bitbake
BASEMACHINE ?= "apq8098"
require conf/machine/include/basemachine.inc

SOC_FAMILY ?= "msmcobalt"
include conf/machine/include/soc-family.inc

# Uncomment the following line to enable the hard floating point abi. Note that
# this breaks some binary libraries and 3D (neither of which ship with
# meta-yocto). For maximum compatibility, leave this disabled.
#DEFAULTTUNE ?= "cortexa8hf-neon"

require conf/machine/include/arm/arch-armv8.inc

BBMASK = ".*/*/recipes-kernel/linux-quic"
BBMASK .= "|.*/*/recipes-security/libselinux/"

MACHINE_DISPLAY_WIDTH_PIXELS ?= "480"
MACHINE_DISPLAY_HEIGHT_PIXELS ?= "640"

SERIAL_CONSOLE = "115200 ttyMSM0"

DISTRO ?= "msm"

MACHINE_FEATURES += "kernel26 keyboard"

PAGE_SIZE ?= '4096'

# Max supported inodes
EXTRA_IMAGECMD ?= "-N 2048"

# Sizes for EXT4 (in bytes)
SYSTEM_SIZE_EXT4 ?= "3000000000"
USERDATA_SIZE_EXT4 ?= "5000000000"
CACHE_SIZE_EXT4 ?= "65536000"

# Multilib configuration
# This sets any packages preprended with lib32- to be built with
# the armv7a tuning (32 bit) instead of 64 bit aarch.
require conf/multilib.conf
MULTILIBS = "multilib:lib32"
DEFAULTTUNE_virtclass-multilib-lib32 = "armv7a"

# Formats of root filesystem images.
IMAGE_FSTYPES += "ext4"
```

## poky/old-meta-qti-bsp/conf/machine/include/basemachine.inc
```bitbake
BASEMACHINE ??= ""

# Add BASEMACHINE to machine overrides
MACHINEOVERRIDES =. "${@['', '${BASEMACHINE}:']['${BASEMACHINE}' != '']}"

# Define BASEMACHINE_ARCH
BASEMACHINE_ARCH = "${@['${MACHINE_ARCH}', '${BASEMACHINE}']['${BASEMACHINE}' != '']}"

# Add BASEMACHINE_ARCH to PACKAGE_ARCHS. 
# This variable is originally set in bitbake.conf
PACKAGE_ARCHS .= "${@['', ' ${BASEMACHINE_ARCH}']['${BASEMACHINE_ARCH}' != '${MACHINE_ARCH}']}"
PACKAGE_ARCHS[vardepsexclude] += "BASEMACHINE_ARCH"
```

## poky/old-meta-qti-bsp/conf/machine/include/mdm9607.inc
```bitbake
BASEMACHINE ?= "mdm9607"
require conf/machine/include/basemachine.inc

SOC_FAMILY ?= "mdm9x07"
include conf/machine/include/soc-family.inc

# Uncomment the following line to enable the hard floating point abi. Note that
# this breaks some binary libraries and 3D (neither of which ship with
# meta-yocto). For maximum compatibility, leave this disabled.
#DEFAULTTUNE ?= "cortexa8hf-neon"

require conf/machine/include/tune-cortexa8.inc

BBMASK = ".*/*/recipes-kernel/linux-msm-4.4"
BBMASK .= "|.*/*/recipes-security/libselinux/"
BBMASK .= "|.*/*/recipes-devtools/mtd/"

MACHINE_DISPLAY_WIDTH_PIXELS ?= "480"
MACHINE_DISPLAY_HEIGHT_PIXELS ?= "640"

SERIAL_CONSOLE ?= "115200 ttyHSL0"

DISTRO ?= "mdm"

MACHINE_FEATURES += "kernel26 keyboard"

PAGE_SIZE ?= '4096'

# Max supported inodes
EXTRA_IMAGECMD ?= "-N 2048"

#UBINIZE Args
UBINIZE_ARGS ?= "-m 4096 -p 256KiB -s 4096"
#MKUBIFS Arg
MKUBIFS_ARGS ?= "-m 4096 -e 253952 -c 2146 -F"
#Volume sizes
SYSTEM_VOLUME_SIZE ?= "74MiB"
CACHE_VOLUME_SIZE ?= "37MiB"
SYSTEMRW_VOLUME_SIZE ?= "6MiB"

# Formats of root filesystem images.
IMAGE_FSTYPES += "ubi"
```

## poky/old-meta-qti-bsp/conf/machine/include/mdm9650.inc
```bitbake
BASEMACHINE ?= "mdm9650"
require conf/machine/include/basemachine.inc

SOC_FAMILY ?= "mdm9x50"
include conf/machine/include/soc-family.inc

# Pull in security flags
require ${COREBASE}/meta-qti-bsp/conf/distro/include/security_flags.inc

# Enable floating-point ABI to Hard-float
DEFAULTTUNE = "cortexa8hf-neon"

# Defines floating-point ABI value suitable to pass to gcc compile flag
# permissable values:hard & softfp.hard allows generation of floating-point
# instructions and uses FPU-specific calling conventions.softfp allows the
# generation of code using hardware floating-point instructions, but still
# uses the soft-float calling conventions. if below line is commented out
# the build defaults to use softfp floating-point ABI.
ARM_FLOAT_ABI = "hard"

include conf/machine/include/tune-cortexa8.inc

BBMASK = ".*/*/recipes-kernel/linux-msm-4.4"
BBMASK .= "|.*/*/recipes-security/libselinux/"
BBMASK .= "|.*/*/recipes-devtools/mtd/"

MACHINE_DISPLAY_WIDTH_PIXELS ?= "480"
MACHINE_DISPLAY_HEIGHT_PIXELS ?= "640"

SERIAL_CONSOLE ?= "115200 ttyHSL0"

DISTRO ?= "mdm"

MACHINE_FEATURES += "kernel26 keyboard ipa-offload"

PAGE_SIZE ?= '4096'

# Max supported inodes
EXTRA_IMAGECMD ?= "-N 2048"

#UBINIZE Args
UBINIZE_ARGS ?= "-m 4096 -p 256KiB -s 4096"
#MKUBIFS Args
MKUBIFS_ARGS ?= "-m 4096 -e 253952 -c 2146 -F"
#Volume sizes
SYSTEM_VOLUME_SIZE ?= "90MiB"
CACHE_VOLUME_SIZE ?= "70MiB"
SYSTEMRW_VOLUME_SIZE ?= "6MiB"

# Sizes for EXT4 (in bytes)
SYSTEM_SIZE_EXT4 ?= "140000000"
SYSTEMRW_SIZE_EXT4 ?= "8388608"
USERDATA_SIZE_EXT4 ?= "2000000000"
CACHE_SIZE_EXT4 ?= "80000000"

#Enable SDK feature
SDK_IMAGE ?= "1"

# Formats of root filesystem images. 
IMAGE_FSTYPES += "ext4 ubi"
```

## poky/old-meta-qti-bsp/conf/machine/include/msm8909w.inc
```bitbake
BASEMACHINE ?= "apq8009"
require conf/machine/include/basemachine.inc

SOC_FAMILY ?= "msm8909"
include conf/machine/include/soc-family.inc

# Uncomment the following line to enable the hard floating point abi. Note that
# this breaks some binary libraries and 3D (neither of which ship with
# meta-yocto). For maximum compatibility, leave this disabled.
#DEFAULTTUNE ?= "cortexa8hf-neon"

require conf/machine/include/apq8009.inc

MACHINE_DISPLAY_WIDTH_PIXELS ?= "320"
MACHINE_DISPLAY_HEIGHT_PIXELS ?= "320"

EXTRA_IMAGECMD ?= "-N 2048"

# Sizes for EXT4 (in bytes)
SYSTEM_SIZE_EXT4 ?= "536870912"
USERDATA_SIZE_EXT4 ?= "200000000"
CACHE_SIZE_EXT4 ?= "65536000"

# Formats of root filesystem images.
IMAGE_FSTYPES = "ext4"
```

## poky/old-meta-qti-bsp/conf/machine/include/sdx20.inc
```bitbake
BASEMACHINE ?= "sdx20"
require conf/machine/include/basemachine.inc

SOC_FAMILY ?= "mdm9x50"
include conf/machine/include/soc-family.inc

# Uncomment the following line to enable the hard floating point abi. Note that
# this breaks some binary libraries and 3D (neither of which ship with
# meta-yocto). For maximum compatibility, leave this disabled.
#DEFAULTTUNE ?= "cortexa8hf-neon"

include conf/machine/include/tune-cortexa8.inc

BBMASK = ".*/*/recipes-kernel/linux-msm-4.4"
BBMASK .= "|.*/*/recipes-security/libselinux/"
BBMASK .= "|.*/*/recipes-devtools/mtd/"

MACHINE_DISPLAY_WIDTH_PIXELS ?= "480"
MACHINE_DISPLAY_HEIGHT_PIXELS ?= "640"

SERIAL_CONSOLE ?= "115200 ttyHSL0"

DISTRO ?= "mdm"

MACHINE_FEATURES += "kernel26 keyboard"

PAGE_SIZE ?= '4096'

# Max supported inodes
EXTRA_IMAGECMD ?= "-N 2048"

#UBINIZE Args
UBINIZE_ARGS ?= "-m 4096 -p 256KiB -s 4096"
#MKUBIFS Args
MKUBIFS_ARGS ?= "-m 4096 -e 253952 -c 2146 -F"
#Volume sizes
SYSTEM_VOLUME_SIZE ?= "90MiB"
CACHE_VOLUME_SIZE ?= "70MiB"
SYSTEMRW_VOLUME_SIZE ?= "6MiB"

# Sizes for EXT4 (in bytes)
SYSTEM_SIZE_EXT4 ?= "200000000"
SYSTEMRW_SIZE_EXT4 ?= "8388608"
USERDATA_SIZE_EXT4 ?= "2000000000"
CACHE_SIZE_EXT4 ?= "80000000"


# Formats of root filesystem images.
IMAGE_FSTYPES += "ext4 ubi"
```

## poky/old-meta-qti-bsp/conf/machine/mdm9650-2k.conf
```bitbake
#@TYPE: Machine
#@NAME: MDM9650-2K
#@DESCRIPTION: Machine configuration for MDM9650 with 2K NAND

require ${COREBASE}/meta-qti-bsp/conf/machine/mdm9650.conf

# Change UBI commands for 2K NAND
PAGE_SIZE = '2048'
UBINIZE_ARGS = "-m 2048 -p 128KiB -s 2048"
MKUBIFS_ARGS = "-m 2048 -e 126976 -c 2047 -F"
```

## poky/old-meta-qti-bsp/conf/machine/mdm9650.conf
```bitbake
#@TYPE: Machine
#@NAME: MDMCALIFORNIUM
#@DESCRIPTION: Machine configuration for QTI MDMCALIFORNIUM MTP

require conf/machine/include/mdm9650.inc

PREFERRED_PROVIDER_virtual/kernel ?= "linux-quic"

KERNEL_IMAGETYPE = "zImage"
KERNEL_DTS_NAME = "mdm9650"
KERNEL_BASE = "0x80000000"
KERNEL_TAGS_OFFSET = "0x82000000"
KERNEL_DEFCONFIG = "mdm_defconfig"
KERNEL_PERF_DEFCONFIG = "mdm-perf_defconfig"
KERNEL_CMD_PARAMS = "noinitrd ro console=ttyHSL0,115200,n8 androidboot.hardware=qcom ehci-hcd.park=3 msm_rtb.filter=0x37 lpm_levels.sleep_disabled=1 earlycon=msm_hsl_uart,0x78b1000"

GCCVERSION = "5.2%"
#Enable Recovery image generation
RECOVERY_IMAGE = "1"
```

## poky/old-meta-qti-bsp/conf/machine/msm8909w.conf
```bitbake
#@TYPE: Machine
#@NAME: MSM8909
#@DESCRIPTION: Machine configuration for QTI MSM8909 MTP

require conf/machine/include/msm8909w.inc

KERNEL_IMAGETYPE = "zImage-dtb"
KERNEL_DTS_NAME = "msm8909w"
KERNEL_BASE = "0x81C00000"
KERNEL_TAGS_OFFSET = "0x81900000"
KERNEL_DEFCONFIG = "msm8909w_defconfig"
KERNEL_PERF_DEFCONFIG = "msm8909w-perf_defconfig"
KERNEL_CMD_PARAMS = "noinitrd rw console=ttyHSL0,115200,n8 androidboot.hardware=qcom ehci-hcd.park=3 msm_rtb.filter=0x37 lpm_levels.sleep_disabled=1"
```

## poky/old-meta-qti-bsp/conf/machine/sdx20.conf
```bitbake
#@TYPE: Machine
#@NAME: SDX20
#@DESCRIPTION: Machine configuration for QTI SDX20

require conf/machine/include/sdx20.inc

PREFERRED_PROVIDER_virtual/kernel ?= "linux-quic"

KERNEL_IMAGETYPE = "zImage"
KERNEL_DTS_NAME = "sdx20"
KERNEL_BASE = "0x80000000"
KERNEL_TAGS_OFFSET = "0x82000000"
KERNEL_DEFCONFIG = "sdx_defconfig"
KERNEL_PERF_DEFCONFIG = "sdx-perf_defconfig"

KERNEL_CMD_PARAMS = "noinitrd ro console=ttyHSL0,115200,n8 androidboot.hardware=qcom ehci-hcd.park=3 msm_rtb.filter=0x37 lpm_levels.sleep_disabled=1 earlycon=msm_hsl_uart,0x78b1000"

# Pull in security flags
require ${COREBASE}/meta-qti-bsp/conf/distro/include/security_flags.inc

#Enable Recovery image generation
RECOVERY_IMAGE = "1"
```
